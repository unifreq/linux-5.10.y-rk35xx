/dts-v1/;
/plugin/;

/ {
	fragment@0 {
		target = <&rkvenc_ccu>;

		__overlay__ {
			status = "okay";
		};
	};

	fragment@1 {
		target = <&rkvenc0>;

		__overlay__ {
			status = "okay";
		};
	};

	fragment@2 {
		target = <&rkvenc0_mmu>;

		__overlay__ {
			status = "okay";
		};
	};
};
