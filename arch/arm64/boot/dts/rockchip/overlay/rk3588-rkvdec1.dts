/dts-v1/;
/plugin/;

/ {
	fragment@0 {
		target = <&rkvdec_ccu>;

		__overlay__ {
			status = "okay";
		};
	};

	fragment@1 {
		target = <&rkvdec1>;

		__overlay__ {
			status = "okay";
		};
	};

	fragment@2 {
		target = <&rkvdec1_mmu>;

		__overlay__ {
			status = "okay";
		};
	};
};
