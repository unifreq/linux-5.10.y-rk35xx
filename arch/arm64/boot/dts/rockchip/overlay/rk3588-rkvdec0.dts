/dts-v1/;
/plugin/;

/ {
	fragment@0 {
		target = <&rkvdec_ccu>;

		__overlay__ {
			status = "okay";
		};
	};

	fragment@1 {
		target = <&rkvdec0>;

		__overlay__ {
			status = "okay";
		};
	};

	fragment@2 {
		target = <&rkvdec0_mmu>;

		__overlay__ {
			status = "okay";
		};
	};
};
