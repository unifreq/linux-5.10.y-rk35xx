// SPDX-License-Identifier: (GPL-2.0+ OR MIT)
// Copyright (c) 2024 Flippy <flippy@sina.com>

/dts-v1/;

#include <dt-bindings/gpio/gpio.h>
#include <dt-bindings/pinctrl/rockchip.h>
#include <dt-bindings/input/rk-input.h>
#include <dt-bindings/pwm/pwm.h>
#include <dt-bindings/display/drm_mipi_dsi.h>
#include <dt-bindings/display/rockchip_vop.h>
#include <dt-bindings/sensor-dev.h>
#include <dt-bindings/leds/common.h>
#include "dt-bindings/usb/pd.h"
#include "rk3588.dtsi"
#include "rk3588-gpio-line-names.dtsi"

/ {
	model = "Hlink AC88";
	compatible = "hlink,ac88", "rockchip,rk3588";

	aliases {
		mmc0 = &sdmmc;
		mmc1 = &sdhci;
		mmc2 = &sdio;
	};

	cspmu: cspmu@fd10c000 {
		compatible = "rockchip,cspmu";
		reg = <0x0 0xfd10c000 0x0 0x1000>,
		      <0x0 0xfd10d000 0x0 0x1000>,
		      <0x0 0xfd10e000 0x0 0x1000>,
		      <0x0 0xfd10f000 0x0 0x1000>,
		      <0x0 0xfd12c000 0x0 0x1000>,
		      <0x0 0xfd12d000 0x0 0x1000>,
		      <0x0 0xfd12e000 0x0 0x1000>,
		      <0x0 0xfd12f000 0x0 0x1000>;
	};

	debug: debug@fd104000 {
		compatible = "rockchip,debug";
		reg = <0x0 0xfd104000 0x0 0x1000>,
		      <0x0 0xfd105000 0x0 0x1000>,
		      <0x0 0xfd106000 0x0 0x1000>,
		      <0x0 0xfd107000 0x0 0x1000>,
		      <0x0 0xfd124000 0x0 0x1000>,
		      <0x0 0xfd125000 0x0 0x1000>,
		      <0x0 0xfd126000 0x0 0x1000>,
		      <0x0 0xfd127000 0x0 0x1000>;
	};

	fiq_debugger: fiq-debugger {
		compatible = "rockchip,fiq-debugger";
		rockchip,serial-id = <2>;
		rockchip,wake-irq = <0>;
		/* If enable uart uses irq instead of fiq */
		rockchip,irq-mode-enable = <1>;
		rockchip,baudrate = <1500000>;  /* Only 115200 and 1500000 */
		interrupts = <GIC_SPI 423 IRQ_TYPE_LEVEL_LOW>;
		pinctrl-names = "default";
		pinctrl-0 = <&uart2m0_xfer>;
		status = "okay";
	};

	firmware: firmware {
		optee: optee {
			compatible = "linaro,optee-tz";
			method = "smc";
		};
	};

	gpio_leds: gpio-leds {
		compatible = "gpio-leds";
		pinctrl-names = "default";
		pinctrl-0 = <&led_green_work_pin>,
		            <&led_blue_sata_pin>,
		            <&led_amber_net_pin>;

		led_green_work: led-green-work {
			label = "green:work";
			gpios = <&gpio1 RK_PD4 GPIO_ACTIVE_HIGH>;
		};

		led_blue_sata: led-blue-sata {
			label = "blue:sata";
			gpios = <&gpio2 RK_PC3 GPIO_ACTIVE_HIGH>;
		};

		led_amber_net: led-amber-net {
			label = "amber:net";
			gpios = <&gpio2 RK_PC5 GPIO_ACTIVE_HIGH>;
		};
	};

	reserved_memory: reserved-memory {
		#address-cells = <2>;
		#size-cells = <2>;
		ranges;

		cma: cma {
			compatible = "shared-dma-pool";
			reusable;
			size = <0x0 (256 * 0x100000)>;
			linux,cma-default;
		};

		drm_logo: drm-logo@00000000 {
			compatible = "rockchip,drm-logo";
			reg = <0x0 0x0 0x0 0x0>;
		};

		drm_cubic_lut: drm-cubic-lut@00000000 {
			compatible = "rockchip,drm-cubic-lut";
			reg = <0x0 0x0 0x0 0x0>;
		};

		ramoops: ramoops@110000 {
			compatible = "ramoops";
			reg = <0x0 0x110000 0x0 0xf0000>;
			record-size = <0x20000>;
			console-size = <0x80000>;
			ftrace-size = <0x00000>;
			pmsg-size = <0x50000>;
		};

               /*
	        * Reserve 256MB memory for hdmirx
                */
               cma_hdmirx: cma-hdmirx {
                       compatible = "shared-dma-pool";
                       reusable;
                       size = <0x0 (256 * 0x100000)>;
               };
	};

	rfkill_modem: rfkill-modem {
		compatible = "rfkill-gpio";
		name = "rfkill-modem";
		pinctrl-names = "default";
		pinctrl-0 = <&modem_reset_pin>;
		reset-gpios = <&gpio4 RK_PC6 GPIO_ACTIVE_HIGH>;
		type = "wwan";
	};

	/*
	rk6280_sound: rk6280-sound {
		compatible = "simple-audio-card";
		simple-audio-card,format = "i2s";
		simple-audio-card,mclk-fs = <128>;
		simple-audio-card,name = "rockchip,hdmi-rk628";
		status = "okay";

		simple-audio-card,cpu {
				sound-dai = <&i2s1_8ch>;
		};
		simple-audio-card,codec {
				sound-dai = <&i2c8_rk628>;
		};
	};
	*/

	/* dc-in or typec-in: maximum supported voltage: 22V */
	vcc12v_dcin: regulator-vcc12v-dcin {
		compatible = "regulator-fixed";
		regulator-name = "vcc12v_dcin";
		regulator-always-on;
		regulator-boot-on;
		regulator-min-microvolt = <12000000>;
		regulator-max-microvolt = <12000000>;
	};

	/* vcc5v0_sys
	 * supply by dc_in
	 * DC-DC convert by MP2491C
	 * maximum load current 6A
	 */
	vcc5v0_sys: regulator-vcc5v0-sys {
		compatible = "regulator-fixed";
		regulator-name = "vcc5v0_sys";
		regulator-always-on;
		regulator-boot-on;
		regulator-min-microvolt = <5000000>;
		regulator-max-microvolt = <5000000>;
		vin-supply = <&vcc12v_dcin>;
	};

	/* vcc4v0_sys
	 * supply by dc_in
	 * DC-DC convert by MP2491C
	 * maximum load current 6A
	 */
	vcc4v0_sys: regulator-vcc4v0-sys {
		compatible = "regulator-fixed";
		regulator-name = "vcc4v0_sys";
		regulator-always-on;
		regulator-boot-on;
		regulator-min-microvolt = <4000000>;
		regulator-max-microvolt = <4000000>;
		startup-delay-us = <100000>;
		vin-supply = <&vcc12v_dcin>;
	};

	/* vcc3v3_sys
	 * supply by dc_in, but enabled by vcc4v0_sys
	 * DC-DC convert by MP2491C
	 * maximum load current 6A
	 */
	vcc3v3_sys: regulator-vcc3v3-sys {
		compatible = "regulator-fixed";
		regulator-name = "vcc3v3_sys";
		regulator-always-on;
		regulator-boot-on;
		regulator-min-microvolt = <3300000>;
		regulator-max-microvolt = <3300000>;
		startup-delay-us = <100000>;
		vin-supply = <&vcc12v_dcin>;
	};

	/* vcc5v0_usb:
	 * supply by dc_in, but enabled by vcc3v3_sys
	 * DC-DC convert by MP2491C
	 * maximum load current 6A
	 */
	vcc5v0_usb: regulator-vcc5v0-usb {
		compatible = "regulator-fixed";
		regulator-name = "vcc5v0_usb";
		regulator-always-on;
		regulator-boot-on;
		regulator-min-microvolt = <5000000>;
		regulator-max-microvolt = <5000000>;
		vin-supply = <&vcc12v_dcin>;
	};

	vbus5v0_typec: regulator-vbus5v0-typec {
		compatible = "regulator-fixed";
		regulator-name = "vbus5v0_typec";
		regulator-min-microvolt = <5000000>;
		regulator-max-microvolt = <5000000>;
		regulator-boot-on;
		enable-active-high;
		gpio = <&gpio1 RK_PB1 GPIO_ACTIVE_HIGH>;
		pinctrl-names = "default";
		pinctrl-0 = <&vbus5v0_typec_en>;
		vin-supply = <&vcc5v0_usb>;
	};

	vcc3v3_sdcard: regulator-vcc3v3-sdcard {
		compatible = "regulator-fixed";
		regulator-name = "vcc3v3_sdcard";
		regulator-min-microvolt = <3300000>;
		regulator-max-microvolt = <3300000>;
		regulator-boot-on;
		enable-active-high;
		gpio = <&gpio4 RK_PB0 GPIO_ACTIVE_HIGH>;
		pinctrl-names = "default";
		pinctrl-0 = <&vcc3v3_sdcard_en>;
		vin-supply = <&vcc3v3_sys>;
	};

	vcc3v8_modem: regulator-vcc3v8-modem {
		compatible = "regulator-fixed";
		regulator-always-on;
		regulator-boot-on;
		regulator-min-microvolt = <3800000>;
		regulator-max-microvolt = <3800000>;
		regulator-name = "vcc3v8_modem";
		vin-supply = <&vcc12v_dcin>;
	};

	vcc3v3_ina: regulator-vcc3v3-ina {
		compatible = "regulator-fixed";
		regulator-always-on;
		regulator-boot-on;
		regulator-min-microvolt = <3300000>;
		regulator-max-microvolt = <3300000>;
		regulator-name = "vcc3v3_ina";
		vin-supply = <&vcc5v0_sys>;
	};

	/* 
	 * vcc3v3 hub
	 */
	vcc3v3_hub: vcc3v3-hub {
		compatible = "regulator-fixed";
		regulator-name = "vcc3v3_hub";
		regulator-always-on;
		regulator-boot-on;
		regulator-min-microvolt = <3300000>;
		regulator-max-microvolt = <3300000>;
		vin-supply = <&vcc3v3_sys>;
	};

	/*
	 * vdd1v2_hub:
	 * DC-DC 1.2V for GL3523 USB HUB
	 * convert by SY8089A1AAC
	 * maximum load current 2A
	 */
	vdd1v2_hub: vdd1v2-hub {
		compatible = "regulator-fixed";
		regulator-name = "vdd1v2_hub";
		regulator-always-on;
		regulator-boot-on;
		regulator-min-microvolt = <1200000>;
		regulator-max-microvolt = <1200000>;
		vin-supply = <&vcc4v0_sys>;
	};

	/* avdd1v2_hub:
	 * LDO 1.2V for GL3523 USB HUB
	 */
	avdd1v2_hub: avdd1v2-hub {
		compatible = "regulator-fixed";
		regulator-name = "avdd1v2_hub";
		regulator-always-on;
		regulator-boot-on;
		regulator-min-microvolt = <1200000>;
		regulator-max-microvolt = <1200000>;
		vin-supply = <&vcc3v3_sys>;
	};

	/* Actually, pull the reset pin of the USB hub high */
	usb_hub_en: usb-hub-en {
		compatible = "regulator-fixed";
		enable-active-high;
		pinctrl-names = "default";
		pintctrl-0 = <&usb_hub_rst_pin>;
		gpio = <&gpio4 RK_PB3 GPIO_ACTIVE_HIGH>;
		regulator-boot-on;
		regulator-always-on;
		regulator-min-microvolt = <3300000>;
		regulator-max-microvolt = <3300000>;
		regulator-name = "usb-hub-en";
		startup-delay-us = <50000>;
		vin-supply = <&vcc3v3_sys>;
	};

	vcc3v3_lcd: regulator-vcc3v3-lcd {
		compatible = "regulator-fixed";
		regulator-name = "vcc3v3_lcd";
		enable-active-high;
		pinctrl-names = "default";
		pintctrl-0 = <&vcc3v3_lcd_pwr_en>;
		gpio = <&gpio1 RK_PA3 GPIO_ACTIVE_HIGH>;
		regulator-min-microvolt = <3300000>;
		regulator-max-microvolt = <3300000>;
		vin-supply = <&vcc5v0_sys>;
	};

	vcc1v8_lcd: regulator-vcc1v8-lcd {
		compatible = "regulator-fixed";
		regulator-name = "vcc1v8_lcd";
		enable-active-high;
		pinctrl-names = "default";
		pintctrl-0 = <&lcdmipi_pwr_en>;
		gpio = <&gpio4 RK_PA0 GPIO_ACTIVE_HIGH>;
		regulator-always-on;
		regulator-boot-on;
		regulator-min-microvolt = <1800000>;
		regulator-max-microvolt = <1800000>;
		vin-supply = <&vcc3v3_sys>;
	};

	vcc_1v1_nldo_s3: vcc-1v1-nldo-s3 {
		compatible = "regulator-fixed";
		regulator-name = "vcc_1v1_nldo_s3";
		regulator-always-on;
		regulator-boot-on;
		regulator-min-microvolt = <1100000>;
		regulator-max-microvolt = <1100000>;
		vin-supply = <&vcc4v0_sys>;
	};

	sdio_pwrseq: sdio-pwrseq {
		compatible = "mmc-pwrseq-simple";
		clocks = <&hym8563>;
		clock-names = "ext_clock";
		pinctrl-names = "default";
		pinctrl-0 = <&wifi_reg_on_h>;
		/*
		 * On the module itself this is one of these (depending
		 * on the actual card populated):
		 * - SDIO_RESET_L_WL_REG_ON
		 * - PDN (power down when low)
		 */
		post-power-on-delay-ms = <200>;
		reset-gpios = <&gpio3 RK_PC7 GPIO_ACTIVE_LOW>;
		status = "okay";
	};

	fan0: pwm-fan {
		compatible = "pwm-fan";
		#cooling-cells = <2>;
		cooling-levels = <0 64 128 192 255>;
		pwms = <&pwm8 0 50000 0>;
	};

	hdmi0_sound: hdmi0-sound {
		status = "okay";
		compatible = "rockchip,hdmi";
		rockchip,mclk-fs = <128>;
		rockchip,card-name = "audio-hdmi0";
		rockchip,cpu = <&i2s5_8ch>;
		rockchip,codec = <&hdmi0>;
		rockchip,jack-det;
	};

	hdmi1_sound: hdmi1-sound {
		status = "okay";
		compatible = "rockchip,hdmi";
		rockchip,mclk-fs = <128>;
		rockchip,card-name = "audio-hdmi1";
		rockchip,cpu = <&i2s6_8ch>;
		rockchip,codec = <&hdmi1>;
		rockchip,jack-det;
	};

	dp0_sound: dp0-sound {
		status = "okay";
		compatible = "rockchip,hdmi";
		rockchip,card-name= "audio-dp0";
		rockchip,mclk-fs = <512>;
		rockchip,cpu = <&spdif_tx2>;
		rockchip,codec = <&dp0 1>;
		rockchip,jack-det;
	};
};

&cpu_l0 {
	cpu-supply = <&vdd_cpu_lit_s0>;
	mem-supply = <&vdd_cpu_lit_mem_s0>;
};

&cpu_b0 {
	cpu-supply = <&vdd_cpu_big0_s0>;
	mem-supply = <&vdd_cpu_big0_mem_s0>;
};

&cpu_b2 {
	cpu-supply = <&vdd_cpu_big1_s0>;
	mem-supply = <&vdd_cpu_big1_mem_s0>;
};

&crypto {
	status = "okay";
};

&dfi {
	status = "okay";
};

&dmc {
	center-supply = <&vdd_ddr_s0>;
	mem-supply = <&vdd_log_s0>;
	status = "okay";
};

&gpu {
	mali-supply = <&vdd_gpu_s0>;
	mem-supply = <&vdd_gpu_mem_s0>;
	status = "okay";
};

&rknpu {
	rknpu-supply = <&vdd_npu_s0>;
	mem-supply = <&vdd_npu_mem_s0>;
	status = "okay";
};

&rknpu_mmu {
	status = "okay";
};

&i2c0 {
	pinctrl-names = "default";
	pinctrl-0 = <&i2c0m2_xfer>;
	status = "okay";

	vdd_cpu_big0_s0: vdd_cpu_big0_mem_s0: rk8602@42 {
		compatible = "rockchip,rk8602";
		reg = <0x42>;
		regulator-always-on;
		regulator-boot-on;
		regulator-compatible = "rk860x-reg";
		regulator-min-microvolt = <550000>;
		regulator-max-microvolt = <1050000>;
		regulator-name = "vdd_cpu_big0_s0";
		regulator-ramp-delay = <2300>;
		rockchip,suspend-voltage-selector = <1>;
		vin-supply = <&vcc4v0_sys>;

		regulator-state-mem {
			regulator-off-in-suspend;
		};
	};

	vdd_cpu_big1_s0: vdd_cpu_big1_mem_s0: rk8603@43 {
		compatible = "rockchip,rk8603";
		reg = <0x43>;
		regulator-always-on;
		regulator-boot-on;
		regulator-compatible = "rk860x-reg";
		regulator-min-microvolt = <550000>;
		regulator-max-microvolt = <1050000>;
		regulator-name = "vdd_cpu_big1_s0";
		regulator-ramp-delay = <2300>;
		rockchip,suspend-voltage-selector = <1>;
		vin-supply = <&vcc4v0_sys>;

		regulator-state-mem {
			regulator-off-in-suspend;
		};
	};

	usbc0: husb311@4e {
		status = "okay";
		compatible = "hynetek,husb311";
		reg = <0x4e>;
		interrupt-parent = <&gpio1>;
		interrupts = <RK_PA0 IRQ_TYPE_LEVEL_LOW>;
		pinctrl-names = "default";
		pinctrl-0 = <&usbc0_int>;
		vbus-supply = <&vbus5v0_typec>;

		ports {
			#address-cells = <1>;
			#size-cells = <0>;

			port@0 {
				reg = <0>;
				usbc0_role_sw: endpoint@0 {
					remote-endpoint = <&dwc3_0_role_switch>;
				};
			};
		};

		usb_con: connector {
			compatible = "usb-c-connector";
			label = "USB-C";
			data-role = "dual";
			power-role = "dual";
			try-power-role = "sink";
			op-sink-microwatt = <1000000>;
			sink-pdos =
				<PDO_FIXED(5000, 3000, PDO_FIXED_USB_COMM)>;
			source-pdos =
				<PDO_FIXED(5000, 3000, PDO_FIXED_USB_COMM)>;

			altmodes {
				#address-cells = <1>;
				#size-cells = <0>;

				altmode@0 {
					reg = <0>;
					svid = <0xff01>;
					vdo = <0xffffffff>;
				};
			};

			ports {
				#address-cells = <1>;
				#size-cells = <0>;

				port@0 {
					reg = <0>;
					usbc0_orien_sw: endpoint {
						remote-endpoint = <&usbdp_phy0_orientation_switch>;
					};
				};

				port@1 {
					reg = <1>;
					dp_altmode_mux: endpoint {
						remote-endpoint = <&usbdp_phy0_dp_altmode_mux>;
					};
				};
			};
		};
	};
};

&i2c2 {
	clock-frequency = <200000>;
	pinctrl-names = "default";
	pinctrl-0 = <&i2c2m0_xfer>;
	status = "okay";

	vdd_npu_s0: vdd_npu_mem_s0: rk8602@42 {
		compatible = "rockchip,rk8602";
		reg = <0x42>;
		regulator-always-on;
		regulator-boot-on;
		regulator-compatible = "rk860x-reg";
		regulator-min-microvolt = <550000>;
		regulator-max-microvolt = <950000>;
		regulator-name = "vdd_npu_s0";
		regulator-ramp-delay = <2300>;
		rockchip,suspend-voltage-selector = <1>;
		vin-supply = <&vcc4v0_sys>;

		regulator-state-mem {
			regulator-off-in-suspend;
		};
	};

	eeprom: eeprom@50 {
		compatible = "atmel,24c02";
		reg = <0x50>;
		address-width = <8>;
		pagesize = <16>;
		size = <256>;
	};

	hym8563: hym8563@51 {
		compatible = "haoyu,hym8563";
		reg = <0x51>;
		#clock-cells = <0>;
		clock-frequency = <32768>;
		clock-output-names = "hym8563";
		interrupt-parent = <&gpio0>;
		interrupts = <RK_PB2 IRQ_TYPE_LEVEL_LOW>;
		pinctrl-names = "default";
		pinctrl-0 = <&rtc_int>;
		wakeup-source;
	};
};

&i2c5 {
	pinctrl-0 = <&i2c5m2_xfer>;
	status = "okay";
};

&i2c8 {
	clock-frequency = <400000>;
	pinctrl-names = "default";
	pinctrl-0 = <&i2c8m2_xfer>;
	status = "okay";

	rk628_csi_0: rk628-csi-0@50 {
		reg = <0x50>;
		compatible = "rockchip,rk628-csi-v4l2";
		status = "okay";
		interrupt-parent = <&gpio4>;
		interrupts = <RK_PA4 IRQ_TYPE_LEVEL_HIGH>;

		//enable-gpios = <&gpio1 RK_PA7 GPIO_ACTIVE_HIGH>;
		pinctrl-names = "default";
		pinctrl-0 = <&rk6280_reset_l>;

		/* Fake reset */
		//reset-gpios = <&gpio2 RK_PB4 GPIO_ACTIVE_LOW>;
		reset-gpios = <&gpio4 RK_PA3 GPIO_ACTIVE_LOW>;

		//plugin-det-gpios = <&gpio1 RK_PA1 GPIO_ACTIVE_LOW>;

		continues-clk = <1>;

		power-domains = <&power RK3588_PD_VI>;

		rockchip,camera-module-index = <0>;
		rockchip,camera-module-facing = "back";
		rockchip,camera-module-name = "HDMI-MIPI";
		rockchip,camera-module-lens-name = "RK628-CSI";

		multi-dev-info {
			dev-idx-l = <0>;
			dev-idx-r = <1>;
			combine-idx = <0>;
			pixel-offset = <0>;
			dev-num = <2>;
		};

		port {
			hdmiin_out0: endpoint {
				remote-endpoint = <&hdmi_mipi0_in>;
				data-lanes = <1 2 3 4>;
			};
		};
	};

	rk628_csi_1: rk628-csi-1@51 {
		reg = <0x51>;
		compatible = "rockchip,rk628-csi-v4l2";
		status = "okay";
		interrupt-parent = <&gpio3>;
		interrupts = <RK_PB4 IRQ_TYPE_LEVEL_HIGH>;

		//enable-gpios = <&gpio1 RK_PB3 GPIO_ACTIVE_HIGH>;

		pinctrl-names = "default";
		pinctrl-0 = <&rk6281_reset_l>;

		//reset-gpios = <&gpio4 RK_PA3 GPIO_ACTIVE_LOW>;
		/* Fake reset */
		reset-gpios = <&gpio2 RK_PB4 GPIO_ACTIVE_LOW>;

		//plugin-det-gpios = <&gpio1 RK_PB4 GPIO_ACTIVE_LOW>;

		continues-clk = <1>;

		power-domains = <&power RK3588_PD_VI>;

		rockchip,camera-module-index = <0>;
		rockchip,camera-module-facing = "back";
		rockchip,camera-module-name = "HDMI-MIPI2";
		rockchip,camera-module-lens-name = "RK628-CSI";

		multi-dev-info {
			dev-idx-l = <2>;
			dev-idx-r = <4>;
			combine-idx = <2>;
			pixel-offset = <0>;
			dev-num = <2>;
		};

		port {
			hdmiin_out1: endpoint {
				remote-endpoint = <&hdmi_mipi1_in>;
				data-lanes = <1 2 3 4>;
			};
		};
	};

};

&csi2_dphy0 {
	status = "okay";

	ports {
		#address-cells = <1>;
		#size-cells = <0>;
		port@0 {
			reg = <0>;
			#address-cells = <1>;
			#size-cells = <0>;

			hdmi_mipi0_in: endpoint@1 {
				reg = <1>;
				remote-endpoint = <&hdmiin_out0>;
				data-lanes = <1 2 3 4>;
			};
		};

		port@1 {
			reg = <1>;
			#address-cells = <1>;
			#size-cells = <0>;

			csidcphy0_out: endpoint@0 {
				reg = <0>;
				remote-endpoint = <&mipi0_csi2_input>;
			};
		};
	};
};

&csi2_dphy0_hw {
	status = "okay";
};

&csi2_dphy1 {
	status = "okay";

	ports {
		#address-cells = <1>;
		#size-cells = <0>;
		port@0 {
			reg = <0>;
			#address-cells = <1>;
			#size-cells = <0>;

			hdmi_mipi1_in: endpoint@1 {
				reg = <1>;
				remote-endpoint = <&hdmiin_out1>;
				data-lanes = <1 2 3 4>;
			};
		};

		port@1 {
			reg = <1>;
			#address-cells = <1>;
			#size-cells = <0>;

			csidphy0_out: endpoint@0 {
				reg = <0>;
				remote-endpoint = <&mipi1_csi2_input>;
			};
		};
	};
};

&csi2_dphy1_hw {
	status = "okay";
};

&mipi_dcphy0 {
	status = "okay";
};

&mipi_dcphy1 {
	status = "okay";
};

&mipi0_csi2 {
	status = "okay";

	ports {
		#address-cells = <1>;
		#size-cells = <0>;

		port@0 {
			reg = <0>;
			#address-cells = <1>;
			#size-cells = <0>;

			mipi0_csi2_input: endpoint@1 {
				reg = <1>;
				remote-endpoint = <&csidcphy0_out>;
			};
		};

		port@1 {
			reg = <1>;
			#address-cells = <1>;
			#size-cells = <0>;

			mipi0_csi2_output: endpoint@0 {
				reg = <0>;
				remote-endpoint = <&cif_mipi_in0>;
			};
		};
	};
};

&mipi1_csi2 {
	status = "okay";

	ports {
		#address-cells = <1>;
		#size-cells = <0>;

		port@0 {
			reg = <0>;
			#address-cells = <1>;
			#size-cells = <0>;

			mipi1_csi2_input: endpoint@1 {
				reg = <1>;
				remote-endpoint = <&csidphy0_out>;
			};
		};

		port@1 {
			reg = <1>;
			#address-cells = <1>;
			#size-cells = <0>;

			mipi1_csi2_output: endpoint@0 {
				reg = <0>;
				remote-endpoint = <&cif_mipi_in1>;
			};
		};
	};
};

&rkcif {
	memory-region = <&cma_hdmirx>;
	memory-region-names = "cma_hdmirx";
	status = "okay";
};

&rkcif_mipi_lvds {
	status = "okay";

	port {
		cif_mipi_in0: endpoint {
			remote-endpoint = <&mipi0_csi2_output>;
		};
	};
};

&rkcif_mipi_lvds1 {
	status = "okay";

	port {
		cif_mipi_in1: endpoint {
			remote-endpoint = <&mipi1_csi2_output>;
		};
	};
};

&rkcif_mmu {
	status = "okay";
};

/* rk6280 i2s */
&i2s1_8ch {
       status = "okay";
       pinctrl-names = "default";
       pinctrl-0 = <&i2s1m0_sclk &i2s1m0_lrck &i2s1m0_sdi0>;
};
 
/* rk6281 i2s */
&i2s2_2ch {
       status = "okay";
       pinctrl-names = "default";
       pinctrl-0 = <&i2s2m1_sclk &i2s2m1_lrck &i2s2m1_sdi>;
};

&i2s5_8ch {
	status = "okay";
};

&i2s6_8ch {
	status = "okay";
};

&i2s7_8ch {
	status = "okay";
};

&spi2 {
	status = "okay";
	assigned-clocks = <&cru CLK_SPI2>;
	assigned-clock-rates = <200000000>;
	pinctrl-names = "default";
	pinctrl-0 = <&spi2m2_cs0 &spi2m2_pins>;
	num-cs = <1>;

	rk806single: rk806single@0 {
		compatible = "rockchip,rk806";
		spi-max-frequency = <1000000>;
		reg = <0x0>;

		interrupt-parent = <&gpio0>;
		interrupts = <7 IRQ_TYPE_LEVEL_LOW>;

		pinctrl-names = "default", "pmic-power-off";
		pinctrl-0 = <&pmic_pins>, <&rk806_dvs1_null>, <&rk806_dvs2_null>, <&rk806_dvs3_null>;
		pinctrl-1 = <&rk806_dvs1_pwrdn>;

		/* 2800mv-3500mv */
		low_voltage_threshold = <3000>;
		/* 2700mv-3400mv */
		shutdown_voltage_threshold = <2700>;
		/* 140 160 */
		shutdown_temperture_threshold = <160>;
		hotdie_temperture_threshold = <115>;

		/* 0: restart PMU;
		 * 1: reset all the power off reset registers,
		 *    forcing the state to switch to ACTIVE mode;
		 * 2: Reset all the power off reset registers,
		 *    forcing the state to switch to ACTIVE mode,
		 *    and simultaneously pull down the RESETB PIN for 5mS before releasing
		 */
		pmic-reset-func = <1>;

		vcc1-supply = <&vcc4v0_sys>;
		vcc2-supply = <&vcc4v0_sys>;
		vcc3-supply = <&vcc4v0_sys>;
		vcc4-supply = <&vcc4v0_sys>;
		vcc5-supply = <&vcc4v0_sys>;
		vcc6-supply = <&vcc4v0_sys>;
		vcc7-supply = <&vcc4v0_sys>;
		vcc8-supply = <&vcc4v0_sys>;
		vcc9-supply = <&vcc4v0_sys>;
		vcc10-supply = <&vcc4v0_sys>;
		vcc11-supply = <&vcc_2v0_pldo_s3>;
		vcc12-supply = <&vcc4v0_sys>;
		vcc13-supply = <&vcc_1v1_nldo_s3>;
		vcc14-supply = <&vcc_1v1_nldo_s3>;
		vcca-supply = <&vcc4v0_sys>;

		pwrkey {
			status = "okay";
		};

		pinctrl_rk806: pinctrl_rk806 {
			gpio-controller;
			#gpio-cells = <2>;

			rk806_dvs1_null: rk806_dvs1_null {
				pins = "gpio_pwrctrl1";
				function = "pin_fun0";
			};

			rk806_dvs1_slp: rk806_dvs1_slp {
				pins = "gpio_pwrctrl1";
				function = "pin_fun1";
			};

			rk806_dvs1_pwrdn: rk806_dvs1_pwrdn {
				pins = "gpio_pwrctrl1";
				function = "pin_fun2";
			};

			rk806_dvs1_rst: rk806_dvs1_rst {
				pins = "gpio_pwrctrl1";
				function = "pin_fun3";
			};

			rk806_dvs2_null: rk806_dvs2_null {
				pins = "gpio_pwrctrl2";
				function = "pin_fun0";
			};

			rk806_dvs2_slp: rk806_dvs2_slp {
				pins = "gpio_pwrctrl2";
				function = "pin_fun1";
			};

			rk806_dvs2_pwrdn: rk806_dvs2_pwrdn {
				pins = "gpio_pwrctrl2";
				function = "pin_fun2";
			};

			rk806_dvs2_rst: rk806_dvs2_rst {
				pins = "gpio_pwrctrl2";
				function = "pin_fun3";
			};

			rk806_dvs2_dvs: rk806_dvs2_dvs {
				pins = "gpio_pwrctrl2";
				function = "pin_fun4";
			};

			rk806_dvs2_gpio: rk806_dvs2_gpio {
				pins = "gpio_pwrctrl2";
				function = "pin_fun5";
			};

			rk806_dvs3_null: rk806_dvs3_null {
				pins = "gpio_pwrctrl3";
				function = "pin_fun0";
			};

			rk806_dvs3_slp: rk806_dvs3_slp {
				pins = "gpio_pwrctrl3";
				function = "pin_fun1";
			};

			rk806_dvs3_pwrdn: rk806_dvs3_pwrdn {
				pins = "gpio_pwrctrl3";
				function = "pin_fun2";
			};

			rk806_dvs3_rst: rk806_dvs3_rst {
				pins = "gpio_pwrctrl3";
				function = "pin_fun3";
			};

			rk806_dvs3_dvs: rk806_dvs3_dvs {
				pins = "gpio_pwrctrl3";
				function = "pin_fun4";
			};

			rk806_dvs3_gpio: rk806_dvs3_gpio {
				pins = "gpio_pwrctrl3";
				function = "pin_fun5";
			};
		};

		regulators {
			vdd_gpu_s0: vdd_gpu_mem_s0: DCDC_REG1 {
				regulator-boot-on;
				regulator-min-microvolt = <550000>;
				regulator-max-microvolt = <950000>;
				regulator-ramp-delay = <12500>;
				regulator-name = "vdd_gpu_s0";
				regulator-enable-ramp-delay = <400>;
				regulator-state-mem {
					regulator-off-in-suspend;
				};
			};

			vdd_cpu_lit_s0: vdd_cpu_lit_mem_s0: DCDC_REG2 {
				regulator-always-on;
				regulator-boot-on;
				regulator-min-microvolt = <550000>;
				regulator-max-microvolt = <950000>;
				regulator-ramp-delay = <12500>;
				regulator-name = "vdd_cpu_lit_s0";
				regulator-state-mem {
					regulator-off-in-suspend;
				};
			};

			vdd_log_s0: DCDC_REG3 {
				regulator-always-on;
				regulator-boot-on;
				regulator-min-microvolt = <675000>;
				regulator-max-microvolt = <750000>;
				regulator-ramp-delay = <12500>;
				regulator-name = "vdd_log_s0";
				regulator-state-mem {
					//regulator-off-in-suspend;
					regulator-on-in-suspend;
					regulator-suspend-microvolt = <750000>;
				};
			};

			vdd_vdenc_s0: vdd_vdenc_mem_s0: DCDC_REG4 {
				regulator-always-on;
				regulator-boot-on;
				regulator-min-microvolt = <550000>;
				regulator-max-microvolt = <950000>;
				regulator-init-microvolt = <750000>;
				regulator-ramp-delay = <12500>;
				regulator-name = "vdd_vdenc_s0";
				regulator-state-mem {
					regulator-off-in-suspend;
				};
			};

			vdd_ddr_s0: DCDC_REG5 {
				regulator-always-on;
				regulator-boot-on;
				regulator-min-microvolt = <675000>;
				regulator-max-microvolt = <900000>;
				regulator-ramp-delay = <12500>;
				regulator-name = "vdd_ddr_s0";
				regulator-state-mem {
					regulator-off-in-suspend;
					regulator-suspend-microvolt = <850000>;
				};
			};

			vdd2_ddr_s3: DCDC_REG6 {
				regulator-always-on;
				regulator-boot-on;
				regulator-name = "vdd2_ddr_s3";
				regulator-state-mem {
					regulator-on-in-suspend;
				};
			};

			vcc_2v0_pldo_s3: DCDC_REG7 {
				regulator-always-on;
				regulator-boot-on;
				regulator-min-microvolt = <2000000>;
				regulator-max-microvolt = <2000000>;
				regulator-name = "vdd_2v0_pldo_s3";
				regulator-state-mem {
					regulator-on-in-suspend;
					regulator-suspend-microvolt = <2000000>;
				};
			};

			vcc_3v3_s3: DCDC_REG8 {
				regulator-always-on;
				regulator-boot-on;
				regulator-min-microvolt = <3300000>;
				regulator-max-microvolt = <3300000>;
				regulator-name = "vcc_3v3_s3";
				regulator-state-mem {
					regulator-on-in-suspend;
					regulator-suspend-microvolt = <3300000>;
				};
			};

			vddq_ddr_s0: DCDC_REG9 {
				regulator-always-on;
				regulator-boot-on;
				regulator-name = "vddq_ddr_s0";
				regulator-state-mem {
					regulator-off-in-suspend;
				};
			};

			vcc_1v8_s3: DCDC_REG10 {
				regulator-always-on;
				regulator-boot-on;
				regulator-min-microvolt = <1800000>;
				regulator-max-microvolt = <1800000>;
				regulator-name = "vcc_1v8_s3";
				regulator-state-mem {
					regulator-on-in-suspend;
					regulator-suspend-microvolt = <1800000>;
				};
			};

			avcc_1v8_s0: PLDO_REG1 {
				regulator-always-on;
				regulator-boot-on;
				regulator-min-microvolt = <1800000>;
				regulator-max-microvolt = <1800000>;
				regulator-name = "avcc_1v8_s0";
				regulator-state-mem {
					//regulator-off-in-suspend;
					regulator-on-in-suspend;
					regulator-suspend-microvolt = <1800000>;
				};
			};

			vcc_1v8_s0: PLDO_REG2 {
				regulator-always-on;
				regulator-boot-on;
				regulator-min-microvolt = <1800000>;
				regulator-max-microvolt = <1800000>;
				regulator-name = "vcc_1v8_s0";
				regulator-state-mem {
					//regulator-off-in-suspend;
					regulator-on-in-suspend;
					regulator-suspend-microvolt = <1800000>;
				};
			};

			avdd_1v2_s0: PLDO_REG3 {
				regulator-always-on;
				regulator-boot-on;
				regulator-min-microvolt = <1200000>;
				regulator-max-microvolt = <1200000>;
				regulator-name = "avdd_1v2_s0";
				regulator-state-mem {
					regulator-off-in-suspend;
				};
			};

			vcc_3v3_s0: PLDO_REG4 {
				regulator-always-on;
				regulator-boot-on;
				regulator-min-microvolt = <3300000>;
				regulator-max-microvolt = <3300000>;
				regulator-name = "vcc_3v3_s0";
				regulator-state-mem {
					//regulator-off-in-suspend;
					regulator-on-in-suspend;
					regulator-suspend-microvolt = <3300000>;
				};
			};

			vccio_sd_s0: PLDO_REG5 {
				regulator-always-on;
				regulator-boot-on;
				regulator-min-microvolt = <1800000>;
				regulator-max-microvolt = <3300000>;
				regulator-name = "vccio_sd_s0";
				regulator-state-mem {
					regulator-off-in-suspend;
				};
			};

			pldo6_s3: PLDO_REG6 {
				regulator-always-on;
				regulator-boot-on;
				regulator-min-microvolt = <1800000>;
				regulator-max-microvolt = <1800000>;
				regulator-name = "pldo6_s3";
				regulator-state-mem {
					regulator-on-in-suspend;
					regulator-suspend-microvolt = <1800000>;
				};
			};

			vdd_0v75_s3: NLDO_REG1 {
				regulator-always-on;
				regulator-boot-on;
				regulator-min-microvolt = <750000>;
				regulator-max-microvolt = <750000>;
				regulator-name = "vdd_0v75_s3";
				regulator-state-mem {
					regulator-on-in-suspend;
					regulator-suspend-microvolt = <750000>;
				};
			};

			vdd_ddr_pll_s0: NLDO_REG2 {
				regulator-always-on;
				regulator-boot-on;
				regulator-min-microvolt = <850000>;
				regulator-max-microvolt = <850000>;
				regulator-name = "vdd_ddr_pll_s0";
				regulator-state-mem {
					//regulator-off-in-suspend;
					regulator-on-in-suspend;
					regulator-suspend-microvolt = <850000>;
				};
			};

			avdd_0v75_s0: NLDO_REG3 {
				regulator-always-on;
				regulator-boot-on;
				regulator-min-microvolt = <837500>;
				regulator-max-microvolt = <837500>;
				regulator-name = "avdd_0v75_s0";
				regulator-state-mem {
					//regulator-off-in-suspend;
					regulator-on-in-suspend;
					regulator-suspend-microvolt = <837500>;
				};
			};

			vdd_0v85_s0: NLDO_REG4 {
				regulator-always-on;
				regulator-boot-on;
				regulator-min-microvolt = <850000>;
				regulator-max-microvolt = <850000>;
				regulator-name = "vdd_0v85_s0";
				regulator-state-mem {
					regulator-off-in-suspend;
				};
			};

			vdd_0v75_s0: NLDO_REG5 {
				regulator-always-on;
				regulator-boot-on;
				regulator-min-microvolt = <750000>;
				regulator-max-microvolt = <750000>;
				regulator-name = "vdd_0v75_s0";
				regulator-state-mem {
					regulator-off-in-suspend;
				};
			};
		};
	};
};

/* LCD:   st7789v, 135(H) x 240(V), 8pin, 4Line SPI
 * pin1:  LEDA:  LED Anode.
 * pin2:  GND:   Power Ground.
 * pin3:  RESET: This signal will reset th device, Signal is active low.
 * pin4:  RS:    Display data/command selection pin in 4-line serial interface.  --> gpio1 RK_PA4
 * pin5:  SDA:   SPI interface input/output pin.                                 --> gpio1 RK_PA1
 * pin6:  SCL:   This pin is used to be serial interface clock                   --> gpio1 RK_PA2
 * pin7:  VDD:   Power Supply for Analog
 * pin8:  CS:    Chip selection pin. Low enable, High disable.                   --> gpio1 RK_PA3
 */
&spi4 {
	#address-cells = <1>;
	#size-cells = <0>;
	assigned-clocks = <&cru CLK_SPI4>;
	assigned-clock-rates = <200000000>;
	num-cs = <1>;
	pinctrl-names = "default";
	pinctrl-0 = <&spi4_custom_pins &spi4m2_cs0>;
	status = "okay";

	panel@0 {
		compatible = "sitronix,st7789v";
		reg = <0>;
		power-supply = <&vcc3v3_lcd>;

		pinctrl-names = "default";
		pinctrl-0 = <&lcd_dc_pin>;
		dc-gpios = <&gpio1 RK_PA4 GPIO_ACTIVE_HIGH>;

		/* 2Mhz */
                spi-max-frequency = <2000000>;

		//width = <135>;
		//height = <240>;
		//fps = <20>;
		buswidth = <8>;
		rotate = <90>;

		/* debug: 0-7 */
		debug = <0>;
		//spi-cpol;
		//spi-cpha;
	};
};

&uart0 {
	pinctrl-names = "default";
	pinctrl-0 = <&uart0m0_xfer>;
	status = "okay";
};

&uart1 {
	pinctrl-names = "default";
	pinctrl-0 = <&uart1m1_xfer>;
	status = "okay";
};

&uart7 {
	pinctrl-names = "default";
	pinctrl-0 = <&uart7m1_xfer &uart7m1_ctsn &uart7m1_rtsn>;
	status = "okay";

	bluetooth: bluetooth {
		compatible = "brcm,bcm4345c5";
		clocks = <&hym8563>;
		clock-names = "ext_clock";

		//BT_WAKE_HOST
		host-wakeup-gpios = <&gpio3 RK_PB0 GPIO_ACTIVE_HIGH>;

		//HOST_WAKE_BT
		device-wakeup-gpios = <&gpio3 RK_PD3 GPIO_ACTIVE_HIGH>;

		//BT_REG_ON_H
		shutdown-gpios = <&gpio3 RK_PA6 GPIO_ACTIVE_HIGH>;

		max-speed = <1500000>;
		pinctrl-names = "default";
		pinctrl-0 = <&bt_wake_host_h &host_wake_bt_h &bt_reg_on_h>;
		vbat-supply = <&vcc3v3_sys>;
		//vddio-supply = <&vcc_1v8_s3>; 
	};
};

/* LT8642UEX-A debug */
&uart9 {
	pinctrl-names = "default";
	pinctrl-0 = <&uart9m2_xfer>;
	status = "okay";
};

&display_subsystem {
	clocks = <&hdptxphy_hdmi_clk0>, <&hdptxphy_hdmi_clk1>;
	clock-names = "hdmi0_phy_pll", "hdmi1_phy_pll";
	memory-region = <&drm_logo>;
	memory-region-names = "drm-logo";
};

&route_hdmi0 {
	status = "okay";
	force-output;
	connect = <&vp0_out_hdmi0>;
};

&route_hdmi1 {
	status = "okay";
	force-output;
	connect = <&vp1_out_hdmi1>;
};

&route_dp0 {
	status = "okay";
	connect = <&vp2_out_dp0>;
};

&hdptxphy_hdmi_clk0 {
	status = "okay";
};

&hdptxphy_hdmi_clk1 {
	status = "okay";
};

&hdptxphy_hdmi0 {
	status = "okay";
};

&hdptxphy_hdmi1 {
	status = "okay";
};

&hdmi0 {
	cec-enable = "true";
	enable-gpios = <&gpio4 RK_PB1 GPIO_ACTIVE_HIGH>;
	status = "okay";
};

&hdmi0_in_vp0 {
	status = "okay";
};

&hdmi0_in_vp1 {
	status = "disabled";
};

&hdmi0_in_vp2 {
	status = "disabled";
};

&hdmi1 {
	cec-enable = "true";
	enable-gpios = <&gpio4 RK_PB2 GPIO_ACTIVE_HIGH>;
	pinctrl-names = "default";
	pinctrl-0 = <&hdmim2_tx1_cec &hdmim0_tx1_hpd &hdmim1_tx1_scl &hdmim1_tx1_sda>;
	status = "okay";
};

&hdmi1_in_vp0 {
	status = "disabled";
};

&hdmi1_in_vp1 {
	status = "okay";
};

&hdmi1_in_vp2 {
	status = "disabled";
};

&dp0 {
	status = "okay";
};

&dp0_in_vp0 {
	status = "disabled";
};

&dp0_in_vp1 {
	status = "disabled";
};

&dp0_in_vp2 {
	status = "okay";
};

&vop {
	status = "okay";
};

&vop_mmu {
	status = "okay";
};

&vepu {
	status = "okay";
};

/* vp0 & vp1 splice for 8K output */
&vp0 {
	rockchip,plane-mask = <(1 << ROCKCHIP_VOP2_CLUSTER0 | 1 << ROCKCHIP_VOP2_ESMART0)>;
	rockchip,primary-plane = <ROCKCHIP_VOP2_CLUSTER0>;
	cursor-win-id = <ROCKCHIP_VOP2_ESMART0>;
};

&vp1 {
	rockchip,plane-mask = <(1 << ROCKCHIP_VOP2_CLUSTER1 | 1 << ROCKCHIP_VOP2_ESMART1)>;
	rockchip,primary-plane = <ROCKCHIP_VOP2_CLUSTER1>;
	cursor-win-id = <ROCKCHIP_VOP2_ESMART1>;
};

&vp2 {
	rockchip,plane-mask = <(1 << ROCKCHIP_VOP2_CLUSTER2 | 1 << ROCKCHIP_VOP2_ESMART2)>;
	rockchip,primary-plane = <ROCKCHIP_VOP2_CLUSTER2>;
	cursor-win-id = <ROCKCHIP_VOP2_ESMART2>;
};

&vp3 {
	rockchip,plane-mask = <(1 << ROCKCHIP_VOP2_CLUSTER3 | 1 << ROCKCHIP_VOP2_ESMART3)>;
	rockchip,primary-plane = <ROCKCHIP_VOP2_CLUSTER3>;
	cursor-win-id = <ROCKCHIP_VOP2_ESMART3>;
};

&av1d {
	status = "okay";
};

&av1d_mmu {
	status = "okay";
};

&iep {
	status = "okay";
};

&iep_mmu {
	status = "okay";
};

&jpegd {
	status = "okay";
};

&jpegd_mmu {
	status = "okay";
};

&jpege_ccu {
	status = "okay";
};

&jpege0 {
	status = "okay";
};

&jpege0_mmu {
	status = "okay";
};

&jpege1 {
	status = "okay";
};

&jpege1_mmu {
	status = "okay";
};

&jpege2 {
	status = "okay";
};

&jpege2_mmu {
	status = "okay";
};

&jpege3 {
	status = "okay";
};

&jpege3_mmu {
	status = "okay";
};

&vdpu {
	status = "okay";
};

&vdpu_mmu {
	status = "okay";
};

&mpp_srv {
	status = "okay";
};

&rga2 {
	status = "okay";
};

&rga3_core0 {
	status = "okay";
};

&rga3_0_mmu {
	status = "okay";
};

&rga3_core1 {
	status = "okay";
};

&rga3_1_mmu {
	status = "okay";
};

/* pwm fan */
&pwm8 {
	pinctrl-names = "active";
	pinctrl-0 = <&pwm8m0_pins>;
	status = "okay";
};

/* backlight */
&pwm12 {
	pinctrl-names = "active";
	pinctrl-0 = <&pwm12m1_pins>;
	status = "okay";
};

&threshold {
	temperature = <60000>;
};

&soc_thermal {
	sustainable-power = <5000>; /* milliwatts */

	cooling-maps {

		map3 {
			trip = <&target>;
			cooling-device =
				<&fan0 THERMAL_NO_LIMIT THERMAL_NO_LIMIT>;
			contribution = <8192>;
		};

		map4 {
			trip = <&threshold>;
			cooling-device =
				<&fan0 THERMAL_NO_LIMIT THERMAL_NO_LIMIT>;
			contribution = <8192>;
		};
	};
};

&rkvdec_ccu {
	status = "okay";
};

&rkvdec0 {
	status = "okay";
};

&rkvdec0_mmu {
	status = "okay";
};

&rkvdec1 {
	status = "okay";
};

&rkvdec1_mmu {
	status = "okay";
};

&rkvenc_ccu {
	status = "okay";
};

&rkvenc0 {
	status = "okay";
	venc-supply = <&vdd_vdenc_s0>;
	mem-supply = <&vdd_vdenc_s0>;
};

&rkvenc0_mmu {
	status = "okay";
};

&rkvenc1 {
	status = "okay";
	venc-supply = <&vdd_vdenc_s0>;
	mem-supply = <&vdd_vdenc_s0>;
};

&rkvenc1_mmu {
	status = "okay";
};

&saradc {
	status = "okay";
	vref-supply = <&avcc_1v8_s0>;
};

&tsadc {
	status = "okay";
};

&rockchip_suspend {
	compatible = "rockchip,pm-rk3588";
	status = "okay";
	rockchip,sleep-debug-en = <1>;
	rockchip,sleep-mode-config = <
		(0
		| RKPM_SLP_ARMOFF_DDRPD
		)
	>;
	rockchip,wakeup-config = <
		(0
		| RKPM_GPIO_WKUP_EN
		| RKPM_USB_WKUP_EN
		)
	>;
};

&rng {
	status = "okay";
};

&sfc {
	status = "disabled";
	max-freq = <50000000>;
	#address-cells = <1>;
	#size-cells = <0>;
	pinctrl-names = "default";
	pinctrl-0 = <&fspim2_pins>;

	spi_flash: spi-flash@0 {
		#address-cells = <1>;
		#size-cells = <0>;
		compatible = "jedec,spi-nor";
		reg = <0x0>;
		spi-max-frequency = <50000000>;
		spi-tx-bus-width = <1>;
		spi-rx-bus-width = <4>;
		status = "okay";

		partitions {
			compatible = "fixed-partitions";
			#address-cells = <1>;
			#size-cells = <1>;

			loader@0 {
				label = "loader";
				reg = <0x0 0x1000000>;
			};
		};
	};
};

/* gmac0: rtl8211f: eth0 */
&gmac0 {
	status = "okay";
	label = "eth0";
	pinctrl-names = "default";
	pinctrl-0 = <&gmac0_miim
		     &gmac0_tx_bus2
		     &gmac0_rx_bus2
		     &gmac0_rgmii_clk
		     &gmac0_rgmii_bus>;

	phy-handle = <&rgmii_phy>;

	clock_in_out = "output";
	phy-mode = "rgmii";
	tx_delay = <0x40>;
	rx_delay = <0x31>;

	snps,reset-gpio = <&gpio2 RK_PB5 GPIO_ACTIVE_LOW>;
	snps,reset-active-low;
	/* Reset time is 20ms, 100ms for rtl8211f */
	snps,reset-delays-us = <0 20000 100000>;
};

&mdio0 {
	rgmii_phy: phy@1 {
		compatible = "ethernet-phy-ieee802.3-c22";
		reg = <0x1>;
		realtek,led-data = <0xc160>;
	};
};

/* Begin of USB
 * TYPEC0 
 *   usbdrd3_0 + usbdrd_dwc3_0 
 *   u2phy0 + u2phy0_otg + usbdp_phy0 + usbdp_phy0_u3
 */
&usbdrd3_0 {
	status = "okay";
};

&usbdrd_dwc3_0 {
	status = "okay";
	dr_mode = "host";
	usb-role-switch;

	port {
		#address-cells = <1>;
		#size-cells = <0>;
		dwc3_0_role_switch: endpoint@0 {
			reg = <0>;
			remote-endpoint = <&usbc0_role_sw>;
		};
	};
};

&u2phy0 {
	status = "okay";
};

&u2phy0_otg {
	status = "okay";
	vbus-supply = <&vbus5v0_typec>;
};

&usbdp_phy0 {
	status = "okay";
	orientation-switch;

	rockchip,dp-lane-mux = < 2 3 >;

	svid = <0xff01>;
	sbu1-dc-gpios = <&gpio0 RK_PC6 GPIO_ACTIVE_HIGH>;
	sbu2-dc-gpios = <&gpio0 RK_PD3 GPIO_ACTIVE_HIGH>;

	port {
		#address-cells = <1>;
		#size-cells = <0>;
		usbdp_phy0_orientation_switch: endpoint@0 {
			reg = <0>;
			remote-endpoint = <&usbc0_orien_sw>;
		};

		usbdp_phy0_dp_altmode_mux: endpoint@1 {
			reg = <1>;
			remote-endpoint = <&dp_altmode_mux>;
		};
	};
};

&usbdp_phy0_u3 {
	status = "okay";
};

&usbdp_phy0_dp {
	status = "okay";
};

/* TYPEC1
 * usbdrd3_1 + usbdrd_dwc3_1
 * u2phy1 + u2phy1_otg + usbdp_phy1 + usbdp_phy1_u3
 */
&usbdrd3_1 {
	status = "okay";
};

/*
 * H88K V3.1: usbdrd_dwc3_1 connect to Genesys GL3523 HUB
 *   HUB port 1 used for M.2 (B Key) socket for 4G/5G modem
 *   HUB port 2-4 used for USB Type-A port 
 */
&usbdrd_dwc3_1 {
	status = "okay";
};

&u2phy1 {
	status = "okay";
};

&u2phy1_otg {
	phy-supply = <&vbus5v0_typec>;
	status = "okay";
};

&usbdp_phy1 {
	status = "okay";
};

&usbdp_phy1_u3 {
	status = "okay";
};

&usbdp_phy1_dp {
	status = "okay";
};

/* USB20_HOST0
 * usb_host0_ehci + usb_host0_ohci
 * u2phy2 + u2phy2_host
 */ 
&usb_host0_ehci {
	status = "okay";
};

&usb_host0_ohci {
	status = "okay";
};

&u2phy2 {
	status = "okay";
};

&u2phy2_host {
	status = "okay";
};

/* USB20_HOST1
 * usb_host1_ehci + usb_host1_ohci
 * u2phy3 + u2phy3_host
 */
&usb_host1_ehci {
	status = "okay";
};

&usb_host1_ohci {
	status = "okay";
};

&u2phy3 {
	status = "okay";
};

&u2phy3_host {
	status = "okay";
};

/*
 * combphy1_ps: phy of pce2x1l0 or sata1
 * AC88: sata phy
 */
&combphy1_ps {
	status = "okay";
};

&sata1 {
	status = "okay";
}; 

/*
 * combphy2_psu: pcie2x1l1 or sata2 or usb30_2 (usbhost3_0 + usbhost_dwc3_0)
 * AC88: usb3.0 phy
 */
&combphy2_psu {
	status = "okay";
};

&sata2 {
	status = "disabled";
}; 

&usbhost3_0 {
	status = "okay";
};

&usbhost_dwc3_0 {
	status = "okay";
};

/*
 * combphy0_ps: pcie2x1l2 or sata0
 * AC88: pcie2.0 phy
 */
&combphy0_ps {
	status = "okay";
};

/*
 * AC88: pcie2x1l2 is M.2 (A+E Key) socket for WiFi/Bluetooth
 */
&pcie2x1l2 {
	reset-gpios = <&gpio0 RK_PB0 GPIO_ACTIVE_HIGH>;
	status = "okay";
	vpcie3v3-supply = <&vcc3v3_sys>;
};

&sata0 {
	status = "disabled";
};

/* pcie3.0 phy: lane1 x 4 mode */
&pcie30phy {
	rockchip,pcie30-phymode = <PHY_MODE_PCIE_NABIBI>;
	status = "okay";
};

/* rtl8111h: eth1 */
&pcie3x4 {
	num-lanes = <1>;	
	rockchip,bifurcation;
	reset-gpios = <&gpio1 RK_PB4 GPIO_ACTIVE_HIGH>;
	status = "okay";
	vpcie3v3-supply = <&vcc3v3_sys>;

	pcie@0,0 {
		bus-range = <0x01 0x0f>;
		device_type = "pci";
		ranges;
		reg = <0x00000000 0 0 0 0>;
		#address-cells = <3>;
		#size-cells = <2>;

		rtl8168_1: pcie-eth@0,0 {
			compatible = "pci10ec,8168";
			label = "eth1";
			reg = <0x00010000 0 0 0 0>;
			realtek,led-data = <0x0870>;
		};
	};
};

/* rtl8111h: eth2 */
&pcie2x1l0 {
	phys = <&pcie30phy>;
	//reset-gpios = <&gpio1 RK_PB4 GPIO_ACTIVE_HIGH>;
	status = "okay";
	vpcie3v3-supply = <&vcc3v3_sys>;

	pcie@0,0 {
		bus-range = <0x21 0x2f>;
		device_type = "pci";
		ranges;
		reg = <0x00200000 0 0 0 0>;
		#address-cells = <3>;
		#size-cells = <2>;

		rtl8168_2: pcie-eth@0,0 {
			compatible = "pci10ec,8168";
			label = "eth2";
			reg = <0x00210000 0 0 0 0>;
			realtek,led-data = <0x0870>;
		};
	};
};

/* rtl8111h: eth3 */
&pcie3x2 {
	rockchip,bifurcation;
	//reset-gpios = <&gpio1 RK_PB4 GPIO_ACTIVE_HIGH>;
	num-lanes = <1>;	
	status = "okay";
	vpcie3v3-supply = <&vcc3v3_sys>;

	pcie@0,0 {
		bus-range = <0x11 0x1f>;
		device_type = "pci";
		ranges;
		reg = <0x00100000 0 0 0 0>;
		#address-cells = <3>;
		#size-cells = <2>;

		rtl8168_3: pcie-eth@0,0 {
			compatible = "pci10ec,8168";
			label = "eth3";
			reg = <0x00110000 0 0 0 0>;
			realtek,led-data = <0x0870>;
		};
	};
};

/*
 * Gold Finger
 * rtl8111h: eth4
 */
&pcie2x1l1 {
	phys = <&pcie30phy>;
	//reset-gpios = <&gpio1 RK_PB4 GPIO_ACTIVE_HIGH>;
	status = "okay";
	vpcie3v3-supply = <&vcc3v3_sys>;

	pcie@0,0 {
		bus-range = <0x31 0x3f>;
		device_type = "pci";
		ranges;
		reg = <0x00300000 0 0 0 0>;
		#address-cells = <3>;
		#size-cells = <2>;

		rtl8168_4: pcie-eth@0,0 {
			compatible = "pci10ec,8168";
			label = "eth4";
			reg = <0x00310000 0 0 0 0>;
			realtek,led-data = <0x0870>;
		};
	};
};

/* TF CARD */
&sdmmc {
	max-frequency = <200000000>;
	sd-uhs-sdr104;
	bus-width = <4>;
	no-mmc;
	no-sdio;
	cap-mmc-highspeed;
	cap-sd-highspeed;
	disable-wp;
	vmmc-supply = <&vcc3v3_sdcard>;
	vqmmc-supply = <&vccio_sd_s0>;
	pinctrl-names = "default";
	pinctrl-0 = <&sdmmc_bus4 &sdmmc_clk &sdmmc_cmd &sdmmc_det>;
	status = "okay";
};

/* EMMC */
&sdhci {
	max-frequency = <200000000>;
	bus-width = <8>;
	non-removable;
	no-sd;
	no-sdio;
	mmc-ddr-1_8v;
	mmc-hs200-1_8v;
	status = "okay";
};

/* SDIO Wifi */
&sdio {
	#address-cells = <1>;
	#size-cells = <0>;
	max-frequency = <150000000>;
	no-sd;
	no-mmc;
	bus-width = <4>;
	disable-wp;
	cap-sd-highspeed;
	cap-sdio-irq;
	keep-power-in-suspend;
	mmc-pwrseq = <&sdio_pwrseq>;
	non-removable;
	pinctrl-names = "default";
	pinctrl-0 = <&sdiom1_pins>;
	status = "okay";

	wifi: wifi@1 {
		//compatible = "aicsemi,aic8800-fdrv";
		compatible = "brcm,bcm4329-fmac";
		reg = <1>;
		interrupt-parent = <&gpio3>;
		interrupts = <RK_PB1 IRQ_TYPE_LEVEL_HIGH>;
		interrupt-names = "host-wake";
		pinctrl-names = "default";
		pinctrl-0 = <&wifi_wake_host_h>;
	};
};

&pinctrl {
	bt {
		bt_reg_on_h: bt-reg-on-h {
			rockchip,pins = <3 RK_PA6 RK_FUNC_GPIO &pcfg_pull_none>;
		};

		host_wake_bt_h: host-wake-bt-h {
			rockchip,pins = <3 RK_PD3 RK_FUNC_GPIO &pcfg_pull_none>;
		};

		bt_wake_host_h: bt-wake-host-h {
			rockchip,pins = <3 RK_PB0 RK_FUNC_GPIO &pcfg_pull_none>;
		};
	};

	wifi {
		wifi_reg_on_h: wifi-reg-on-h {
			rockchip,pins = <3 RK_PC7 RK_FUNC_GPIO &pcfg_pull_none>;
		};

		host_wake_wifi_h: host-wake-wifi-h {
			rockchip,pins = <3 RK_PD2 RK_FUNC_GPIO &pcfg_pull_none>;
		};

		wifi_wake_host_h: wifi-wake-host-h {
			rockchip,pins = <3 RK_PB1 RK_FUNC_GPIO &pcfg_pull_none>;
		};
	};

	lcd {
		vcc3v3_lcd_pwr_en: vcc3v3-lcd-pwr-en {
			rockchip,pins = <1 RK_PA3 RK_FUNC_GPIO &pcfg_pull_none>;
		};

		lcdmipi_pwr_en: lcdmipi-pwr-en {
			rockchip,pins = <4 RK_PA0 RK_FUNC_GPIO &pcfg_pull_none>;
		};

		lcd_dc_pin: lcd-dc-pin {
			rockchip,pins = <1 RK_PA4 RK_FUNC_GPIO &pcfg_pull_up_drv_level_6>;
		};

		spi4_custom_pins: spi4-custom-pins {
			rockchip,pins =
				/* spi4_clk_m2 */
				<1 RK_PA2 8 &pcfg_pull_up_drv_level_6>,
				/* spi4_mosi_m2 */
				<1 RK_PA1 8 &pcfg_pull_up_drv_level_6>,
				/* spi4_miso_m0 */
				<1 RK_PC0 8 &pcfg_pull_up_drv_level_6>;
		};
	};

	leds {
		led_green_work_pin: led-green-work-pin {
			rockchip,pins = <1 RK_PD4 RK_FUNC_GPIO &pcfg_pull_none>;
		};

		led_blue_sata_pin: led-blue-sata-pin {
			rockchip,pins = <2 RK_PC3 RK_FUNC_GPIO &pcfg_pull_none>;
		};

		led_amber_net_pin: led-amber-net-pin {
			rockchip,pins = <2 RK_PC5 RK_FUNC_GPIO &pcfg_pull_none>;
		};
	};

	modem {
		modem_reset_pin: modem-reset-pin {
			rockchip,pins = <4 RK_PC6 RK_FUNC_GPIO &pcfg_pull_down>;
		};
	};

	rtc {
		rtc_int: rtc-int {
			rockchip,pins = <0 RK_PB2 RK_FUNC_GPIO &pcfg_pull_none>;
		};
	};

	rk628 {
		rk6280_reset_l: rk6280-reset-l {
			rockchip,pins = <4 RK_PA3 RK_FUNC_GPIO &pcfg_pull_none>;
		};

		rk6281_reset_l: rk6281-reset-l {
			rockchip,pins = <2 RK_PB4 RK_FUNC_GPIO &pcfg_pull_none>; // fake reset
		};
	};

	sdcard {
		vcc3v3_sdcard_en: vcc3v3_sdcard_en {
			rockchip,pins = <4 RK_PB0 RK_FUNC_GPIO &pcfg_pull_none>;
		};
	};

	usb {
		usbc0_int: usbc0-int {
			rockchip,pins = <1 RK_PA0 RK_FUNC_GPIO &pcfg_pull_none>;
		};

		usb_hub_rst_pin: usb-hub-rst-pin {
			rockchip,pins = <4 RK_PB3 RK_FUNC_GPIO &pcfg_pull_none>;
		};

		vbus5v0_typec_en: vbus5v0-typec-en {
			rockchip,pins = <1 RK_PB1 RK_FUNC_GPIO &pcfg_pull_none>;
		};
	};
};

&gpio0 {
	gpio-line-names =
		/* GPIO0_A0-A3 */
		"", "", "", "",
		/* GPIO0_A4-A7 */
		"", "", "", "",

		/* GPIO0_B0-B3 */
		"", "", "", "",
		/* GPIO0_B4-B7 */
		"", "PIN_8", "PIN_10", "",

		/* GPIO0_C0-C3 */
		"", "", "", "",
		/* GPIO0_C4-C7 */
		"", "", "", "",

		/* GPIO0_D0-D3 */
		"", "", "", "",
		/* GPIO0_D4-D7 */
		"", "", "", "";
};

&gpio1 {
	gpio-line-names =
		/* GPIO1_A0-A3 */
		"", "", "", "",
		/* GPIO1_A4-A7 */
		"", "", "", "",

		/* GPIO1_B0-B3 */
		"", "PIN_21", "PIN_19", "PIN_23",
		/* GPIO1_B4-B7 */
		"PIN_24", "PIN_26", "", "PIN_31",

		/* GPIO1_C0-C3 */
		"", "", "", "",
		/* GPIO1_C4-C7 */
		"", "", "", "",

		/* GPIO1_D0-D3 */
		"", "", "", "",
		/* GPIO1_D4-D7 */
		"", "", "", "PIN_29";
};

&gpio2 {
	gpio-line-names =
		/* GPIO2_A0-A3 */
		"", "", "", "",
		/* GPIO2_A4-A7 */
		"", "", "", "",

		/* GPIO2_B0-B3 */
		"", "", "", "",
		/* GPIO2_B4-B7 */
		"", "", "", "",

		/* GPIO2_C0-C3 */
		"", "", "", "",
		/* GPIO2_C4-C7 */
		"", "", "", "",

		/* GPIO2_D0-D3 */
		"", "", "", "",
		/* GPIO2_D4-D7 */
		"", "", "", "";
};

&gpio3 {
	gpio-line-names =
		/* GPIO3_A0-A3 */
		"", "", "", "",
		/* GPIO3_A4-A7 */
		"PIN_16", "", "", "PIN_33",

		/* GPIO3_B0-B3 */
		"", "PIN_36", "PIN_38", "PIN_40",
		/* GPIO3_B4-B7 */
		"", "PIN_12", "PIN_35", "PIN_13",

		/* GPIO3_C0-C3 */
		"PIN_15", "PIN_11", "PIN_32", "PIN_7",
		/* GPIO3_C4-C7 */
		"", "", "", "",

		/* GPIO3_D0-D3 */
		"", "", "", "",
		/* GPIO3_D4-D7 */
		"", "", "", "";
};

&gpio4 {
	gpio-line-names =
		/* GPIO4_A0-A3 */
		"", "", "", "",
		/* GPIO4_A4-A7 */
		"", "", "", "",

		/* GPIO4_B0-B3 */
		"", "", "PIN_5", "PIN_3",
		/* GPIO4_B4-B7 */
		"", "", "", "",

		/* GPIO4_C0-C3 */
		"", "", "", "",
		/* GPIO4_C4-C7 */
		"PIN_18", "PIN_28", "PIN_27", "",

		/* GPIO4_D0-D3 */
		"", "", "", "",
		/* GPIO4_D4-D7 */
		"", "", "", "";
};
