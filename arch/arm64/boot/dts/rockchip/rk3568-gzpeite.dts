// SPDX-License-Identifier: (GPL-2.0+ OR MIT)
/*
 * Copyright (c) 2020 Rockchip Electronics Co., Ltd.
 *
 */

/dts-v1/;

#include <dt-bindings/gpio/gpio.h>
#include <dt-bindings/pwm/pwm.h>
#include <dt-bindings/pinctrl/rockchip.h>
#include <dt-bindings/input/rk-input.h>
#include <dt-bindings/display/drm_mipi_dsi.h>
#include <dt-bindings/sensor-dev.h>
#include <dt-bindings/display/media-bus-format.h>
#include <dt-bindings/display/rockchip_vop.h>
#include "rk3568.dtsi"

/ {
  model = "GZPEITE RK3568 P01";
  compatible = "rockchip,rk3568";

  aliases {
    mmc0 = &sdmmc0;
    mmc1 = &sdmmc1;
    mmc2 = &sdhci;
    mmc3 = &sdmmc2;
    rtc1 = &pcf8563;
  };

  chosen: chosen {
    bootargs = "earlycon=uart8250,mmio32,0xfe660000 console=ttyFIQ0";
  };

  fiq-debugger {
    compatible = "rockchip,fiq-debugger";
    rockchip,serial-id = <2>;
    rockchip,wake-irq = <0>;
    /* If enable uart uses irq instead of fiq */
    rockchip,irq-mode-enable = <1>;
    rockchip,baudrate = <115200>;  /* Only 115200 and 1500000 */
    interrupts = <GIC_SPI 252 IRQ_TYPE_LEVEL_LOW>;
    pinctrl-names = "default";
    pinctrl-0 = <&uart2m0_xfer>;
    status = "okay";
  };

  debug: debug@fd904000 {
    compatible = "rockchip,debug";
    reg = <0x0 0xfd904000 0x0 0x1000>,
      <0x0 0xfd905000 0x0 0x1000>,
      <0x0 0xfd906000 0x0 0x1000>,
      <0x0 0xfd907000 0x0 0x1000>;
  };

  cspmu: cspmu@fd90c000 {
    compatible = "rockchip,cspmu";
    reg = <0x0 0xfd90c000 0x0 0x1000>,
      <0x0 0xfd90d000 0x0 0x1000>,
      <0x0 0xfd90e000 0x0 0x1000>,
      <0x0 0xfd90f000 0x0 0x1000>;
  };

  dc_12v: dc-12v {
    compatible = "regulator-fixed";
    regulator-name = "dc_12v";
    regulator-always-on;
    regulator-boot-on;
    regulator-min-microvolt = <12000000>;
    regulator-max-microvolt = <12000000>;
  };

  vcc3v3_sys: vcc3v3-sys {
    compatible = "regulator-fixed";
    regulator-name = "vcc3v3_sys";
    regulator-always-on;
    regulator-boot-on;
    regulator-min-microvolt = <3300000>;
    regulator-max-microvolt = <3300000>;
    vin-supply = <&dc_12v>;
  };

  vcc5v0_sys: vcc5v0-sys {
    compatible = "regulator-fixed";
    regulator-name = "vcc5v0_sys";
    regulator-always-on;
    regulator-boot-on;
    regulator-min-microvolt = <5000000>;
    regulator-max-microvolt = <5000000>;
    vin-supply = <&dc_12v>;
  };

  vcc3v3_pcie: gpio-regulator {
    compatible = "regulator-fixed";
    regulator-name = "vcc3v3_pcie";
    regulator-min-microvolt = <3300000>;
    regulator-max-microvolt = <3300000>;
    enable-active-high;
    regulator-always-on;
    gpio = <&gpio4 RK_PD2 GPIO_ACTIVE_HIGH>;
    startup-delay-us = <5000>;
    vin-supply = <&dc_12v>;
  };

  vcc3v3_bu: vcc3v3-bu {
    compatible = "regulator-fixed";
    regulator-name = "vcc3v3_bu";
    regulator-always-on;
    regulator-boot-on;
    regulator-min-microvolt = <3300000>;
    regulator-max-microvolt = <3300000>;
    vin-supply = <&vcc5v0_sys>;
  };

  vcc3v3_lcd0_n: vcc3v3-lcd0-n {
    compatible = "regulator-fixed";
    regulator-name = "vcc3v3_lcd0_n";
    regulator-boot-on;
    regulator-min-microvolt = <3300000>;
    regulator-max-microvolt = <3300000>;
    enable-active-high;
    gpio = <&gpio3 RK_PB6 GPIO_ACTIVE_HIGH>;
    vin-supply = <&vcc3v3_sys>;
    regulator-state-mem {
      regulator-off-in-suspend;
    };
  };

  ext_cam_clk: external-camera-clock {
    compatible = "fixed-clock";
    clock-frequency = <24000000>;
    clock-output-names = "CLK_CAMERA_24MHZ";
    #clock-cells = <0>;
  };

  hdmi_osc: hdmi-osc {
    compatible = "fixed-clock";
    clock-output-names = "hdmi-osc";
    clock-frequency = <27000000>;
    #clock-cells = <0>;
  };

  rk_headset: rk-headset {
    status = "okay";
    compatible = "rockchip_headset";
    headset_gpio = <&gpio1 RK_PB0 GPIO_ACTIVE_HIGH>;
    pinctrl-names = "default";
    pinctrl-0 = <&hp_det>;
  };

  adc_keys: adc-keys {
    compatible = "adc-keys";
    io-channels = <&saradc 0>;
    io-channel-names = "buttons";
    keyup-threshold-microvolt = <1800000>;
    poll-interval = <100>;

    vol-up-key {
      label = "volume up";
      linux,code = <KEY_VOLUMEUP>;
      press-threshold-microvolt = <1750>;
    };

    vol-down-key {
      label = "volume down";
      linux,code = <KEY_VOLUMEDOWN>;
      press-threshold-microvolt = <297500>;
    };

    menu-key {
      label = "menu";
      linux,code = <KEY_MENU>;
      press-threshold-microvolt = <980000>;
    };

    back-key {
      label = "back";
      linux,code = <KEY_BACK>;
      press-threshold-microvolt = <1305500>;
    };
  };

  audiopwmout_diff: audiopwmout-diff {
    status = "disabled";
    compatible = "simple-audio-card";
    simple-audio-card,format = "i2s";
    simple-audio-card,name = "rockchip,audiopwmout-diff";
    simple-audio-card,mclk-fs = <256>;
    simple-audio-card,bitclock-master = <&master>;
    simple-audio-card,frame-master = <&master>;
    simple-audio-card,cpu {
      sound-dai = <&i2s3_2ch>;
    };
    master: simple-audio-card,codec {
      sound-dai = <&dig_acodec>;
    };
  };

  backlight: backlight {
    status = "disabled";
    compatible = "pwm-backlight";
    brightness-levels = <
        0   1   2   3   4   5   6   7
        8   9  10  11  12  13  14  15
       16  17  18  19  20  21  22  23
       24  25  26  27  28  29  30  31
       32  33  34  35  36  37  38  39
       40  41  42  43  44  45  46  47
       48  49  50  51  52  53  54  55
       56  57  58  59  60  61  62  63
       64  65  66  67  68  69  70  71
       72  73  74  75  76  77  78  79
       80  81  82  83  84  85  86  87
       88  89  90  91  92  93  94  95
       96  97  98  99 100 101 102 103
      104 105 106 107 108 109 110 111
      112 113 114 115 116 117 118 119
      120 121 122 123 124 125 126 127
      128 129 130 131 132 133 134 135
      136 137 138 139 140 141 142 143
      144 145 146 147 148 149 150 151
      152 153 154 155 156 157 158 159
      160 161 162 163 164 165 166 167
      168 169 170 171 172 173 174 175
      176 177 178 179 180 181 182 183
      184 185 186 187 188 189 190 191
      192 193 194 195 196 197 198 199
      200 201 202 203 204 205 206 207
      208 209 210 211 212 213 214 215
      216 217 218 219 220 221 222 223
      224 225 226 227 228 229 230 231
      232 233 234 235 236 237 238 239
      240 241 242 243 244 245 246 247
      248 249 250 251 252 253 254 255
    >;
    default-brightness-level = <200>;
    pwm_min_limit   = <30>;
    pwm_max_limit   = <255>;
    enable-gpios = <&gpio0 RK_PA5 GPIO_ACTIVE_HIGH>;
//    pwms = <&pwm0 0 25000 0>, <&pwm4 0 25000 0>, <&pwm5 0 25000 0>;
    pwms = <&pwm0 0 25000 1>, <&pwm4 0 25000 1>, <&pwm5 0 25000 1>;
    pwm-names = "bl0", "bl1", "bl2";
  };

  hdmi_sound: hdmi-sound {
    status = "disabled";
    compatible = "simple-audio-card";
    simple-audio-card,format = "i2s";
    simple-audio-card,mclk-fs = <128>;
    simple-audio-card,name = "rockchip,hdmi";

    simple-audio-card,cpu {
        sound-dai = <&i2s0_8ch>;
    };
    simple-audio-card,codec {
        sound-dai = <&hdmi>;
    };
  };

  rk809_sound: rk809-sound {
    status = "okay";
    compatible = "rockchip,multicodecs-card";
    rockchip,card-name = "rockchip-rk809";
    hp-det-gpio = <&gpio3 RK_PA1 GPIO_ACTIVE_LOW>;
    rockchip,format = "i2s";
    rockchip,mclk-fs = <256>;
    rockchip,cpu = <&i2s1_8ch>;
    rockchip,codec = <&rk809_codec>;
//    pinctrl-names = "default";
//    pinctrl-0 = <&hp_det>;
  };

  spdif-sound {
    status = "disabled";
    compatible = "simple-audio-card";
    simple-audio-card,name = "ROCKCHIP,SPDIF";
    simple-audio-card,mclk-fs = <128>;
    simple-audio-card,cpu {
        sound-dai = <&spdif_8ch>;
    };
    simple-audio-card,codec {
        sound-dai = <&spdif_out>;
    };
  };

  spdif_out: spdif-out {
      status = "disabled";
      compatible = "linux,spdif-dit";
      #sound-dai-cells = <0>;
  };

  vad_sound: vad-sound {
    status = "disabled";
    compatible = "rockchip,multicodecs-card";
    rockchip,card-name = "rockchip,rk3568-vad";
    rockchip,cpu = <&i2s1_8ch>;
    rockchip,codec = <&rk809_codec>, <&vad>;
  };

  sdio_pwrseq: sdio-pwrseq {
    compatible = "mmc-pwrseq-simple";
    clocks = <&rk809 1>;
    clock-names = "ext_clock";
    pinctrl-names = "default";
    pinctrl-0 = <&wifi_enable_h>;

    /*
     * On the module itself this is one of these (depending
     * on the actual card populated):
     * - SDIO_RESET_L_WL_REG_ON
     * - PDN (power down when low)
     */
    post-power-on-delay-ms = <200>;
    reset-gpios = <&gpio3 RK_PD5 GPIO_ACTIVE_LOW>;
  };

  wireless_wlan: wireless-wlan {
    status = "okay";
    compatible = "wlan-platdata";
    rockchip,grf = <&grf>;
    wifi_chip_type = "";
//    pinctrl-names = "default";
//    pinctrl-0 = <&wifi_enable_h>;
//    pinctrl-0 = <&wifi_host_wake_irq>;
//    WIFI,host_wake_irq = <&gpio3 RK_PD4 GPIO_ACTIVE_HIGH>;
//    WIFI,poweren_gpio = <&gpio3 RK_PD5 GPIO_ACTIVE_HIGH>;
    keep_wifi_power_on;
  };

  wireless_bluetooth: wireless-bluetooth {
    status = "okay";
    compatible = "bluetooth-platdata";
    clocks = <&rk809 1>;
    clock-names = "ext_clock";
    //wifi-bt-power-toggle;
    uart_rts_gpios = <&gpio2 RK_PB1 GPIO_ACTIVE_LOW>;
    pinctrl-names = "default", "rts_gpio";
    pinctrl-0 = <&uart8m0_rtsn>;
    pinctrl-1 = <&uart8_gpios>;
    BT,reset_gpio    = <&gpio3 RK_PA0 GPIO_ACTIVE_HIGH>;
    BT,wake_gpio     = <&gpio3 RK_PA2 GPIO_ACTIVE_HIGH>;
//    BT,wake_host_irq = <&gpio2 RK_PD7 GPIO_ACTIVE_HIGH>;
  };

  test-power {
    status = "disabled";
  };

  gpio_gzpeite {
    compatible = "gpio_gzpeite";
    status = "okay";

    gpio0-name = "GPIO_DEBUG_LED";
    gpio0 = <&gpio0 RK_PC7 1>;

    gpio1-name = "GPIO_4G_PWR";
    gpio1 = <&gpio1 RK_PB2 0>;

    gpio2-name = "GPIO_4G_RST";
    gpio2 = <&gpio1 RK_PB1 0>;

    gpio3-name = "GPIO_USER_01";
    gpio3 = <&gpio3 RK_PC1 0>;

    gpio4-name = "GPIO_USER_02";
    gpio4 = <&gpio1 RK_PD2 0>;

    gpio5-name = "GPIO_USER_03";
    gpio5 = <&gpio3 RK_PA1 0>;

    gpio6-name = "GPIO_USER_04";
    gpio6 = <&gpio1 RK_PD3 0>;

    gpio7-name = "GPIO_USER_05";
    gpio7 = <&gpio2 RK_PD0 0>;

    gpio8-name = "GPIO_USER_06";
    gpio8 = <&gpio1 RK_PD4 0>;

    gpio9-name = "GPIO_USER_07";
    gpio9 = <&gpio3 RK_PC3 0>;

    gpio10-name = "GPIO_USER_08";
    gpio10 = <&gpio4 RK_PC4 0>;

    gpio11-name = "GPIO_USER_09";
    gpio11 = <&gpio3 RK_PC2 0>;

    gpio12-name = "GPIO_USER_10";
    gpio12 = <&gpio2 RK_PD7 0>;

    gpio13-name = "GPIO_USER_11";
    gpio13 = <&gpio1 RK_PD1 0>;

    gpio14-name = "GPIO_USER_12";
    gpio14 = <&gpio3 RK_PA7 0>;

    gpio15-name = "GPIO_NFC_02";
    gpio15 = <&gpio1 RK_PA1 0>;

    gpio16-name = "GPIO_FAN_PWR";
    gpio16 = <&gpio2 RK_PD2 0>;

    pinctrl-names = "default";
    pinctrl-0 = <&bootinit_gpio>;
  };

  gpio_uboot {
    compatible = "gpio_uboot";
    status = "okay";

    pinctrl-names = "default";
    pinctrl-0 = <&uboot_gpio>;
  };

  lvds_panel: lvds-panel {
    status = "disabled";
    compatible ="simple-panel";
    backlight = <&backlight>;
    power-supply = <&vcc3v3_lcd0_n>;
    enable-delay-ms = <20>;
    prepare-delay-ms = <20>;
    unprepare-delay-ms = <20>;
    disable-delay-ms = <20>;
    enable-gpios = <&gpio3 RK_PB5 GPIO_ACTIVE_HIGH>;

//    bus-format = <MEDIA_BUS_FMT_RGB666_1X7X3_JEIDA>; /* jeida-18 */
//    bus-format = <MEDIA_BUS_FMT_RGB888_1X7X4_JEIDA>; /* jeida-24 */
//    bus-format = <MEDIA_BUS_FMT_RGB666_1X7X3_SPWG>; /* vesa-18 */
//    bus-format = <MEDIA_BUS_FMT_RGB888_1X7X4_SPWG>; /* vesa-24 */

    //1024*600 signal channel LVDS
    bus-format = <MEDIA_BUS_FMT_RGB888_1X7X4_SPWG>;
    display-timings {
      native-mode = <&timing1>;
      timing1: timing1 {
        clock-frequency = <55000000>;
        hactive = <1024>;
        vactive = <600>;
        hback-porch = <190>;
        hfront-porch = <130>;
        hsync-len = <100>;
        vback-porch = <23>;
        vfront-porch = <12>;
        vsync-len = <1>;
        pixelclk-active = <0>;
        hsync-active = <0>;
        vsync-active = <0>;
        de-active = <0>;
      };
    };

    ports {
      #address-cells = <1>;
      #size-cells = <0>;

      port@0 {
        reg = <0>;
        panel_in_lvds: endpoint {
          remote-endpoint = <&lvds_out_panel>;
        };
      };
    };
  };

  edp_panel: edp-panel {
    status = "disabled";
    compatible = "simple-panel";
    backlight = <&backlight>;
    power-supply = <&vcc3v3_lcd0_n>;
    prepare-delay-ms = <120>;
    enable-delay-ms = <120>;
    unprepare-delay-ms = <120>;
    disable-delay-ms = <120>;
    enable-gpios = <&gpio3 RK_PB5 GPIO_ACTIVE_HIGH>;

    display-timings {
      native-mode = <&edp_timing>;

      edp_timing: timing0 {
        clock-frequency = <146000000>;
        hactive = <1920>;
        vactive = <1080>;
        hfront-porch = <48>;
        hsync-len = <32>;
        hback-porch = <120>;
        vfront-porch = <23>;
        vsync-len = <25>;
        vback-porch = <22>;
        hsync-active = <0>;
        vsync-active = <0>;
        de-active = <0>;
        pixelclk-active = <0>;

//        clock-frequency = <286000000>;
//        hactive = <2560>;
//        vactive = <1600>;
//        hfront-porch = <120>;
//        hsync-len = <110>;
//        hback-porch = <10>;
//        vfront-porch = <50>;
//        vsync-len = <50>;
//        vback-porch = <4>;
//        hsync-active = <0>;
//        vsync-active = <0>;
//        de-active = <0>;
//        pixelclk-active = <0>;
      };
    };

    port {
      panel_in_edp: endpoint {
        remote-endpoint = <&edp_out_panel>;
      };
    };
  };

};

&edp_phy {
  status = "disabled";
};

&edp {
  status = "disabled";
  force-hpd;
//  hpd-gpios = <&gpio0 RK_PC2 GPIO_ACTIVE_HIGH>;

  ports {
    port@1 {
      reg = <1>;

      edp_out_panel: endpoint {
        remote-endpoint = <&panel_in_edp>;
      };
    };
  };
};

&lvds {
  status = "disabled";

  ports {
    port@1 {
      reg = <1>;

      lvds_out_panel: endpoint {
        remote-endpoint = <&panel_in_lvds>;
      };
    };
  };
};

&bus_npu {
  bus-supply = <&vdd_logic>;
  pvtm-supply = <&vdd_cpu>;
  status = "disabled";
};

&can1 {
  status = "okay";
  assigned-clocks = <&cru CLK_CAN1>;
//  assigned-clock-rates = <150000000>;
  assigned-clock-rates = <100000000>;
  pinctrl-names = "default";
  pinctrl-0 = <&can1m1_pins>;
};

&cpu0 {
  cpu-supply = <&vdd_cpu>;
};

&dfi {
  status = "okay";
};

&dmc {
  center-supply = <&vdd_logic>;
  status = "okay";
};

/* video_phy0 needs to be enabled when dsi0 is enabled */
&dsi0 {
  status = "disabled";
  //rockchip,lane-rate = <1000>;

  dsi0_panel: panel@0 {
    status = "disabled";

    compatible = "simple-panel-dsi";
    reg = <0>;
    power-supply = <&vcc3v3_lcd0_n>;
    vsp-supply = <&vcc_1v8>;
//    vsn-supply = <&outn>;
    backlight = <&backlight>;
    enable-gpios = <&gpio3 RK_PB5 GPIO_ACTIVE_HIGH>;
    reset-delay-ms = <120>;
    init-delay-ms = <120>;
    enable-delay-ms = <120>;
    prepare-delay-ms = <120>;
    unprepare-delay-ms = <120>;
    disable-delay-ms = <120>;
    dsi,flags = <(MIPI_DSI_MODE_VIDEO | MIPI_DSI_MODE_VIDEO_BURST | MIPI_DSI_MODE_LPM | MIPI_DSI_MODE_EOT_PACKET)>;
    dsi,format = <MIPI_DSI_FMT_RGB888>;
    dsi,lanes = <4>;
    panel-init-sequence = [
      39 00 04 FF 98 81 03
      15 00 02 01 00
      15 00 02 02 00
      15 00 02 03 53
      15 00 02 04 D3
      15 00 02 05 00
      15 00 02 06 0D
      15 00 02 07 08
      15 00 02 08 00
      15 00 02 09 00
      15 00 02 0A 00
      15 00 02 0B 00
      15 00 02 0C 00
      15 00 02 0D 00
      15 00 02 0E 00
      15 00 02 0F 28
      15 00 02 10 28
      15 00 02 11 00
      15 00 02 12 00
      15 00 02 13 00
      15 00 02 14 00
      15 00 02 15 00
      15 00 02 16 00
      15 00 02 17 00
      15 00 02 18 00
      15 00 02 19 00
      15 00 02 1A 00
      15 00 02 1B 00
      15 00 02 1C 00
      15 00 02 1D 00
      15 00 02 1E 40
      15 00 02 1F 80
      15 00 02 20 06
      15 00 02 21 01
      15 00 02 22 00
      15 00 02 23 00
      15 00 02 24 00
      15 00 02 25 00
      15 00 02 26 00
      15 00 02 27 00
      15 00 02 28 33
      15 00 02 29 33
      15 00 02 2A 00
      15 00 02 2B 00
      15 00 02 2C 00
      15 00 02 2D 00
      15 00 02 2E 00
      15 00 02 2F 00
      15 00 02 30 00
      15 00 02 31 00
      15 00 02 32 00
      15 00 02 33 00
      15 00 02 34 03
      15 00 02 35 00
      15 00 02 36 00
      15 00 02 37 00
      15 00 02 38 96
      15 00 02 39 00
      15 00 02 3A 00
      15 00 02 3B 00
      15 00 02 3C 00
      15 00 02 3D 00
      15 00 02 3E 00
      15 00 02 3F 00
      15 00 02 40 00
      15 00 02 41 00
      15 00 02 42 00
      15 00 02 43 00
      15 00 02 44 00
      15 00 02 50 00
      15 00 02 51 23
      15 00 02 52 45
      15 00 02 53 67
      15 00 02 54 89
      15 00 02 55 AB
      15 00 02 56 01
      15 00 02 57 23
      15 00 02 58 45
      15 00 02 59 67
      15 00 02 5A 89
      15 00 02 5B AB
      15 00 02 5C CD
      15 00 02 5D EF
      15 00 02 5E 00
      15 00 02 5F 08
      15 00 02 60 08
      15 00 02 61 06
      15 00 02 62 06
      15 00 02 63 01
      15 00 02 64 01
      15 00 02 65 00
      15 00 02 66 00
      15 00 02 67 02
      15 00 02 68 15
      15 00 02 69 15
      15 00 02 6A 14
      15 00 02 6B 14
      15 00 02 6C 0D
      15 00 02 6D 0D
      15 00 02 6E 0C
      15 00 02 6F 0C
      15 00 02 70 0F
      15 00 02 71 0F
      15 00 02 72 0E
      15 00 02 73 0E
      15 00 02 74 02
      15 00 02 75 08
      15 00 02 76 08
      15 00 02 77 06
      15 00 02 78 06
      15 00 02 79 01
      15 00 02 7A 01
      15 00 02 7B 00
      15 00 02 7C 00
      15 00 02 7D 02
      15 00 02 7E 15
      15 00 02 7F 15
      15 00 02 80 14
      15 00 02 81 14
      15 00 02 82 0D
      15 00 02 83 0D
      15 00 02 84 0C
      15 00 02 85 0C
      15 00 02 86 0F
      15 00 02 87 0F
      15 00 02 88 0E
      15 00 02 89 0E
      15 00 02 8A 02
      39 00 04 FF 98 81 04
      15 00 02 6E 2B
      15 00 02 6F 37
      15 00 02 3A 24
      15 00 02 8D 1A
      15 00 02 87 BA
      15 00 02 B2 D1
      15 00 02 88 0B
      15 00 02 38 01
      15 00 02 39 00
      15 00 02 B5 02
      15 00 02 31 25
      15 00 02 3B 98
      39 00 04 FF 98 81 01
      15 00 02 22 0A
      15 00 02 31 00
      15 00 02 53 5A
      15 00 02 55 3D
      15 00 02 50 85
      15 00 02 51 80
      15 00 02 60 06
      15 00 02 62 20
      15 00 02 A0 00
      15 00 02 A1 13
      15 00 02 A2 20
      15 00 02 A3 11
      15 00 02 A4 16
      15 00 02 A5 28
      15 00 02 A6 1C
      15 00 02 A7 1F
      15 00 02 A8 84
      15 00 02 A9 1E
      15 00 02 AA 29
      15 00 02 AB 74
      15 00 02 AC 1A
      15 00 02 AD 19
      15 00 02 AE 4B
      15 00 02 AF 22
      15 00 02 B0 29
      15 00 02 B1 4B
      15 00 02 B2 58
      15 00 02 B3 23
      15 00 02 C0 00
      15 00 02 C1 12
      15 00 02 C2 21
      15 00 02 C3 12
      15 00 02 C4 16
      15 00 02 C5 29
      15 00 02 C6 1D
      15 00 02 C7 1F
      15 00 02 C8 85
      15 00 02 C9 1D
      15 00 02 CA 29
      15 00 02 CB 74
      15 00 02 CC 1A
      15 00 02 CD 19
      15 00 02 CE 4C
      15 00 02 CF 22
      15 00 02 D0 29
      15 00 02 D1 4B
      15 00 02 D2 58
      15 00 02 D3 23
      39 00 04 FF 98 81 00
      05 C8 01 11
      05 14 01 29
      15 00 02 35 00
    ];

    panel-exit-sequence = [
      05 00 01 28
      05 00 01 10
    ];

    disp_timings0: display-timings {
      native-mode = <&dsi0_timing0>;

      dsi0_timing0: timing0 {
        clock-frequency = <72000000>;
        hactive = <800>;
        vactive = <1280>;
        hback-porch = <60>;
        hfront-porch = <20>;
        hsync-len = <40>;
        vback-porch = <20>;
//          vback-porch = <8>;
        vfront-porch = <30>;
        vsync-len = <4>;
        hsync-active = <0>;
        vsync-active = <0>;
        de-active = <0>;
        pixelclk-active = <0>;
      };
    };

    ports {
      #address-cells = <1>;
      #size-cells = <0>;

      port@0 {
        reg = <0>;
        panel_in_dsi: endpoint {
          remote-endpoint = <&dsi_out_panel>;
        };
      };
    };
  };

  ports {
    #address-cells = <1>;
    #size-cells = <0>;

    port@1 {
      reg = <1>;
      dsi_out_panel: endpoint {
        remote-endpoint = <&panel_in_dsi>;
      };
    };
  };

};

/* video_phy1 needs to be enabled when dsi1 is enabled */
&dsi1 {
  status = "disabled";
  //rockchip,lane-rate = <1000>;

  dsi1_panel: panel@0 {
    status = "disabled";

    compatible = "simple-panel-dsi";
    reg = <0>;
    power-supply = <&vcc3v3_lcd0_n>;
    vsp-supply = <&vcc_1v8>;
//    vsn-supply = <&outn>;
    backlight = <&backlight>;
    backlignt_name = "bl1";
    enable-gpios = <&gpio3 RK_PB5 GPIO_ACTIVE_HIGH>;
    reset-delay-ms = <120>;
    init-delay-ms = <120>;
    enable-delay-ms = <120>;
    prepare-delay-ms = <120>;
    unprepare-delay-ms = <120>;
    disable-delay-ms = <120>;
    dsi,flags = <(MIPI_DSI_MODE_VIDEO | MIPI_DSI_MODE_VIDEO_BURST | MIPI_DSI_MODE_LPM | MIPI_DSI_MODE_EOT_PACKET)>;
    dsi,format = <MIPI_DSI_FMT_RGB888>;
    dsi,lanes = <4>;
    panel-init-sequence = [
      39 00 04 FF 98 81 03
      15 00 02 01 00
      15 00 02 02 00
      15 00 02 03 53
      15 00 02 04 D3
      15 00 02 05 00
      15 00 02 06 0D
      15 00 02 07 08
      15 00 02 08 00
      15 00 02 09 00
      15 00 02 0A 00
      15 00 02 0B 00
      15 00 02 0C 00
      15 00 02 0D 00
      15 00 02 0E 00
      15 00 02 0F 28
      15 00 02 10 28
      15 00 02 11 00
      15 00 02 12 00
      15 00 02 13 00
      15 00 02 14 00
      15 00 02 15 00
      15 00 02 16 00
      15 00 02 17 00
      15 00 02 18 00
      15 00 02 19 00
      15 00 02 1A 00
      15 00 02 1B 00
      15 00 02 1C 00
      15 00 02 1D 00
      15 00 02 1E 40
      15 00 02 1F 80
      15 00 02 20 06
      15 00 02 21 01
      15 00 02 22 00
      15 00 02 23 00
      15 00 02 24 00
      15 00 02 25 00
      15 00 02 26 00
      15 00 02 27 00
      15 00 02 28 33
      15 00 02 29 33
      15 00 02 2A 00
      15 00 02 2B 00
      15 00 02 2C 00
      15 00 02 2D 00
      15 00 02 2E 00
      15 00 02 2F 00
      15 00 02 30 00
      15 00 02 31 00
      15 00 02 32 00
      15 00 02 33 00
      15 00 02 34 03
      15 00 02 35 00
      15 00 02 36 00
      15 00 02 37 00
      15 00 02 38 96
      15 00 02 39 00
      15 00 02 3A 00
      15 00 02 3B 00
      15 00 02 3C 00
      15 00 02 3D 00
      15 00 02 3E 00
      15 00 02 3F 00
      15 00 02 40 00
      15 00 02 41 00
      15 00 02 42 00
      15 00 02 43 00
      15 00 02 44 00
      15 00 02 50 00
      15 00 02 51 23
      15 00 02 52 45
      15 00 02 53 67
      15 00 02 54 89
      15 00 02 55 AB
      15 00 02 56 01
      15 00 02 57 23
      15 00 02 58 45
      15 00 02 59 67
      15 00 02 5A 89
      15 00 02 5B AB
      15 00 02 5C CD
      15 00 02 5D EF
      15 00 02 5E 00
      15 00 02 5F 08
      15 00 02 60 08
      15 00 02 61 06
      15 00 02 62 06
      15 00 02 63 01
      15 00 02 64 01
      15 00 02 65 00
      15 00 02 66 00
      15 00 02 67 02
      15 00 02 68 15
      15 00 02 69 15
      15 00 02 6A 14
      15 00 02 6B 14
      15 00 02 6C 0D
      15 00 02 6D 0D
      15 00 02 6E 0C
      15 00 02 6F 0C
      15 00 02 70 0F
      15 00 02 71 0F
      15 00 02 72 0E
      15 00 02 73 0E
      15 00 02 74 02
      15 00 02 75 08
      15 00 02 76 08
      15 00 02 77 06
      15 00 02 78 06
      15 00 02 79 01
      15 00 02 7A 01
      15 00 02 7B 00
      15 00 02 7C 00
      15 00 02 7D 02
      15 00 02 7E 15
      15 00 02 7F 15
      15 00 02 80 14
      15 00 02 81 14
      15 00 02 82 0D
      15 00 02 83 0D
      15 00 02 84 0C
      15 00 02 85 0C
      15 00 02 86 0F
      15 00 02 87 0F
      15 00 02 88 0E
      15 00 02 89 0E
      15 00 02 8A 02
      39 00 04 FF 98 81 04
      15 00 02 6E 2B
      15 00 02 6F 37
      15 00 02 3A 24
      15 00 02 8D 1A
      15 00 02 87 BA
      15 00 02 B2 D1
      15 00 02 88 0B
      15 00 02 38 01
      15 00 02 39 00
      15 00 02 B5 02
      15 00 02 31 25
      15 00 02 3B 98
      39 00 04 FF 98 81 01
      15 00 02 22 0A
      15 00 02 31 00
      15 00 02 53 5A
      15 00 02 55 3D
      15 00 02 50 85
      15 00 02 51 80
      15 00 02 60 06
      15 00 02 62 20
      15 00 02 A0 00
      15 00 02 A1 13
      15 00 02 A2 20
      15 00 02 A3 11
      15 00 02 A4 16
      15 00 02 A5 28
      15 00 02 A6 1C
      15 00 02 A7 1F
      15 00 02 A8 84
      15 00 02 A9 1E
      15 00 02 AA 29
      15 00 02 AB 74
      15 00 02 AC 1A
      15 00 02 AD 19
      15 00 02 AE 4B
      15 00 02 AF 22
      15 00 02 B0 29
      15 00 02 B1 4B
      15 00 02 B2 58
      15 00 02 B3 23
      15 00 02 C0 00
      15 00 02 C1 12
      15 00 02 C2 21
      15 00 02 C3 12
      15 00 02 C4 16
      15 00 02 C5 29
      15 00 02 C6 1D
      15 00 02 C7 1F
      15 00 02 C8 85
      15 00 02 C9 1D
      15 00 02 CA 29
      15 00 02 CB 74
      15 00 02 CC 1A
      15 00 02 CD 19
      15 00 02 CE 4C
      15 00 02 CF 22
      15 00 02 D0 29
      15 00 02 D1 4B
      15 00 02 D2 58
      15 00 02 D3 23
      39 00 04 FF 98 81 00
      05 C8 01 11
      05 14 01 29
      15 00 02 35 00
    ];

    panel-exit-sequence = [
      05 00 01 28
      05 00 01 10
    ];

    disp_timings1: display-timings {
      native-mode = <&dsi1_timing0>;

      dsi1_timing0: timing0 {
        clock-frequency = <72000000>;
        hactive = <800>;
        vactive = <1280>;
        hback-porch = <60>;
        hfront-porch = <20>;
        hsync-len = <40>;
        vback-porch = <20>;
//          vback-porch = <8>;
        vfront-porch = <30>;
        vsync-len = <4>;
        hsync-active = <0>;
        vsync-active = <0>;
        de-active = <0>;
        pixelclk-active = <0>;
      };
    };

    ports {
      #address-cells = <1>;
      #size-cells = <0>;

      port@0 {
        reg = <0>;
        panel_in_dsi1: endpoint {
          remote-endpoint = <&dsi1_out_panel>;
        };
      };
    };
  };

  ports {
    #address-cells = <1>;
    #size-cells = <0>;

    port@1 {
      reg = <1>;
      dsi1_out_panel: endpoint {
        remote-endpoint = <&panel_in_dsi1>;
      };
    };
  };

};

&gpu {
  mali-supply = <&vdd_gpu>;
  status = "okay";
};

&hdmi {
  status = "okay";
  force_hpd = <1>;
  rockchip,phy-table =
    <92812500  0x8009 0x0000 0x0270>,
    <165000000 0x800b 0x0000 0x026d>,
    <185625000 0x800b 0x0000 0x01ed>,
    <297000000 0x800b 0x0000 0x01ad>,
    <594000000 0x8029 0x0000 0x0088>,
    <000000000 0x0000 0x0000 0x0000>;
};

&video_phy0 {
  status = "okay";
};

&video_phy1 {
  status = "okay";
};

&dsi0_in_vp0 {
  status = "disabled";
};

&dsi0_in_vp1 {
  status = "disabled";
};

&dsi1_in_vp0 {
  status = "disabled";
};

&dsi1_in_vp1 {
  status = "disabled";
};

&lvds_in_vp1 {
  status = "disabled";
};

&lvds_in_vp2 {
  status = "disabled";
};

&edp_in_vp0 {
  status = "disabled";
};

&edp_in_vp1 {
  status = "disabled";
};

&hdmi_in_vp0 {
  status = "okay";
};

&hdmi_in_vp1 {
  status = "disabled";
};

&route_hdmi {
  status = "okay";
  connect = <&vp0_out_hdmi>;
//  connect = <&vp1_out_hdmi>;
};

&route_dsi0 {
  status = "disabled";
  connect = <&vp1_out_dsi0>;
};

&route_dsi1 {
  status = "disabled";
  connect = <&vp1_out_dsi1>;
};

&route_edp {
  status = "disabled";
  connect = <&vp1_out_edp>;
};

&route_lvds {
  status = "disabled";
  connect = <&vp2_out_lvds>;
};

&route_rgb {
  status = "disabled";
  connect = <&vp2_out_rgb>;
};

&i2c0 {
  status = "okay";

  vdd_cpu: tcs4525@1c {
//    status = "disabled";
    compatible = "tcs,tcs4525";
    reg = <0x1c>;
    vin-supply = <&vcc5v0_sys>;
    regulator-compatible = "fan53555-reg";
    regulator-name = "vdd_cpu";
    regulator-min-microvolt = <712500>;
    regulator-max-microvolt = <1390000>;
    regulator-init-microvolt = <900000>;
    regulator-initial-mode = <1>;
    regulator-ramp-delay = <2300>;
    fcs,suspend-voltage-selector = <1>;
    regulator-boot-on;
    regulator-always-on;
    regulator-state-mem {
      regulator-off-in-suspend;
    };
  };

  rk809: pmic@20 {
    compatible = "rockchip,rk809";
    reg = <0x20>;
    interrupt-parent = <&gpio0>;
    interrupts = <3 IRQ_TYPE_LEVEL_LOW>;

    pinctrl-names = "default";
    pinctrl-0 = <&pmic_int>;

    rockchip,system-power-controller;
    wakeup-source;
    #clock-cells = <1>;
    clock-output-names = "rk808-clkout1", "rk808-clkout2";
    //fb-inner-reg-idxs = <2>;
    /* 1: rst regs (default in codes), 0: rst the pmic */
    pmic-reset-func = <0>;
    /* not save the PMIC_POWER_EN register in uboot */
    not-save-power-en = <1>;

    vcc1-supply = <&vcc3v3_sys>;
    vcc2-supply = <&vcc3v3_sys>;
    vcc3-supply = <&vcc3v3_sys>;
    vcc4-supply = <&vcc3v3_sys>;
    vcc5-supply = <&vcc3v3_sys>;
    vcc6-supply = <&vcc3v3_sys>;
    vcc7-supply = <&vcc3v3_sys>;
    vcc8-supply = <&vcc3v3_sys>;
    vcc9-supply = <&vcc3v3_sys>;

    pwrkey {
      status = "okay";
    };

    pinctrl_rk8xx: pinctrl_rk8xx {
      gpio-controller;
      #gpio-cells = <2>;

      rk817_slppin_null: rk817_slppin_null {
        pins = "gpio_slp";
        function = "pin_fun0";
      };

      rk817_slppin_slp: rk817_slppin_slp {
        pins = "gpio_slp";
        function = "pin_fun1";
      };

      rk817_slppin_pwrdn: rk817_slppin_pwrdn {
        pins = "gpio_slp";
        function = "pin_fun2";
      };

      rk817_slppin_rst: rk817_slppin_rst {
        pins = "gpio_slp";
        function = "pin_fun3";
      };
    };

    regulators {
      vdd_logic: DCDC_REG1 {
        regulator-always-on;
        regulator-boot-on;
        regulator-min-microvolt = <500000>;
        regulator-max-microvolt = <1350000>;
        regulator-init-microvolt = <900000>;
        regulator-ramp-delay = <6001>;
        regulator-initial-mode = <0x2>;
        regulator-name = "vdd_logic";
        regulator-state-mem {
          regulator-off-in-suspend;
        };
      };

      vdd_gpu: DCDC_REG2 {
        regulator-always-on;
        regulator-boot-on;
        regulator-min-microvolt = <500000>;
        regulator-max-microvolt = <1350000>;
        regulator-init-microvolt = <900000>;
        regulator-ramp-delay = <6001>;
        regulator-initial-mode = <0x2>;
        regulator-name = "vdd_gpu";
        regulator-state-mem {
          regulator-off-in-suspend;
        };
      };

      vcc_ddr: DCDC_REG3 {
        regulator-always-on;
        regulator-boot-on;
        regulator-initial-mode = <0x2>;
        regulator-name = "vcc_ddr";
        regulator-state-mem {
          regulator-on-in-suspend;
        };
      };

      vdd_npu: DCDC_REG4 {
        regulator-always-on;
        regulator-boot-on;
        regulator-min-microvolt = <500000>;
        regulator-max-microvolt = <1350000>;
        regulator-init-microvolt = <900000>;
        regulator-ramp-delay = <6001>;
        regulator-initial-mode = <0x2>;
        regulator-name = "vdd_npu";
        regulator-state-mem {
          regulator-off-in-suspend;
        };
      };

      vdda0v9_image: LDO_REG1 {
        regulator-boot-on;
        regulator-always-on;
        regulator-min-microvolt = <900000>;
        regulator-max-microvolt = <900000>;
        regulator-name = "vdda0v9_image";
        regulator-state-mem {
          regulator-off-in-suspend;
        };
      };

      vdda_0v9: LDO_REG2 {
        regulator-always-on;
        regulator-boot-on;
        regulator-min-microvolt = <900000>;
        regulator-max-microvolt = <900000>;
        regulator-name = "vdda_0v9";
        regulator-state-mem {
          regulator-off-in-suspend;
        };
      };

      vdda0v9_pmu: LDO_REG3 {
        regulator-always-on;
        regulator-boot-on;
        regulator-min-microvolt = <900000>;
        regulator-max-microvolt = <900000>;
        regulator-name = "vdda0v9_pmu";
        regulator-state-mem {
          regulator-on-in-suspend;
          regulator-suspend-microvolt = <900000>;
        };
      };

      vccio_acodec: LDO_REG4 {
        regulator-always-on;
        regulator-boot-on;
        regulator-min-microvolt = <3000000>;
        regulator-max-microvolt = <3000000>;
        regulator-name = "vccio_acodec";
        regulator-state-mem {
          regulator-off-in-suspend;
        };
      };

      vccio_sd: LDO_REG5 {
        regulator-always-on;
        regulator-boot-on;
        regulator-min-microvolt = <1800000>;
        regulator-max-microvolt = <3300000>;
        regulator-name = "vccio_sd";
        regulator-state-mem {
          regulator-off-in-suspend;
        };
      };

      vcc3v3_pmu: LDO_REG6 {
        regulator-always-on;
        regulator-boot-on;
        regulator-min-microvolt = <3300000>;
        regulator-max-microvolt = <3300000>;
        regulator-name = "vcc3v3_pmu";
        regulator-state-mem {
          regulator-on-in-suspend;
          regulator-suspend-microvolt = <3300000>;
        };
      };

      vcca_1v8: LDO_REG7 {
        regulator-always-on;
        regulator-boot-on;
        regulator-min-microvolt = <1800000>;
        regulator-max-microvolt = <1800000>;
        regulator-name = "vcca_1v8";
        regulator-state-mem {
          regulator-off-in-suspend;
        };
      };

      vcca1v8_pmu: LDO_REG8 {
        regulator-always-on;
        regulator-boot-on;
        regulator-min-microvolt = <1800000>;
        regulator-max-microvolt = <1800000>;
        regulator-name = "vcca1v8_pmu";
        regulator-state-mem {
          regulator-on-in-suspend;
          regulator-suspend-microvolt = <1800000>;
        };
      };

      vcca1v8_image: LDO_REG9 {
        regulator-always-on;
        regulator-boot-on;
        regulator-min-microvolt = <1800000>;
        regulator-max-microvolt = <1800000>;
        regulator-name = "vcca1v8_image";
        regulator-state-mem {
          regulator-off-in-suspend;
        };
      };

      vcc_1v8: DCDC_REG5 {
        regulator-always-on;
        regulator-boot-on;
        regulator-min-microvolt = <1800000>;
        regulator-max-microvolt = <1800000>;
        regulator-name = "vcc_1v8";
        regulator-state-mem {
          regulator-off-in-suspend;
        };
      };

      vcc_3v3: SWITCH_REG1 {
        regulator-always-on;
        regulator-boot-on;
        regulator-name = "vcc_3v3";
        regulator-state-mem {
          regulator-off-in-suspend;
        };
      };

      vcc3v3_sd: SWITCH_REG2 {
        regulator-always-on;
        regulator-boot-on;
        regulator-name = "vcc3v3_sd";
        regulator-state-mem {
          regulator-off-in-suspend;
        };
      };
    };

    rk809_codec: codec {
      #sound-dai-cells = <1>;
      compatible = "rockchip,rk809-codec", "rockchip,rk817-codec";
      clocks = <&cru I2S1_MCLKOUT>;
      clock-names = "mclk";
      assigned-clocks = <&cru I2S1_MCLKOUT>, <&cru I2S1_MCLK_TX_IOE>;
      assigned-clock-rates = <12288000>;
      assigned-clock-parents = <&cru I2S1_MCLKOUT_TX>, <&cru I2S1_MCLKOUT_TX>;
      pinctrl-names = "default";
      pinctrl-0 = <&i2s1m0_mclk>;
      hp-volume = <20>;
      spk-volume = <3>;
      mic-in-differential;
      status = "okay";
    };
  };
};

&i2c1 {
  status = "okay";

  gt9xx: gt9xx@14{
    status = "disabled";
    compatible = "goodix,gt9xx";
    reg = <0x14>;
    reset-gpios = <&gpio0 RK_PB6 GPIO_ACTIVE_LOW>;
    irq-gpios = <&gpio0 RK_PB5 IRQ_TYPE_LEVEL_LOW>;
    goodix,type-a-report = <0>;
    goodix,int-sync = <1>;
    goodix,pen-suppress-finger = <0>;
    goodix,esd-protect = <0>;
    goodix,auto-update-cfg = <0>;
    goodix,resume-in-workqueue = <0>;
    goodix,power-off-sleep = <0>;
    goodix,double-wakeup = <0>;
    goodix,swap-x2y = <0>;
    goodix,revert-x = <0>;
    goodix,revert-y = <0>;
    goodix,driver-send-cfg = <0>;
    goodix,cfg-group0 = [
      82 00 04 58 02 05 3D 20 22 08 28 08 5F 41 03 05
      00 00 00 00 00 00 00 17 1A 1E 14 8C 2E 0E 99 9B
      B2 04 00 00 00 22 01 1D 00 01 00 00 00 00 00 00
      00 00 00 82 B4 9E D5 F4 07 00 00 04 89 86 00 84
      8F 00 7F 99 00 7B A3 00 77 AE 00 77 00 00 00 00
      00 00 00 00 00 00 00 00 00 00 00 00 00 00 00 00
      00 00 00 00 00 00 00 00 00 00 00 00 00 00 00 00
      02 04 06 08 0A 0C 0E 10 12 14 16 18 1A 1C 00 00
      00 00 00 00 00 00 00 00 00 00 00 00 00 00 00 02
      04 06 08 0A 0C 0F 10 12 13 14 16 18 1C 1D 1E 1F
      20 21 22 24 26 28 29 2A 00 00 00 00 00 00 00 00
      00 00 00 00 00 00 00 00 AA 01
    ];
  };

  pcf8563: pcf8563@51 {
    compatible = "nxp,pcf8563";
    reg = <0x51>;
    #clock-cells = <0>;
    status = "okay";
  };

};

&i2c2 {
  status = "okay";
  pinctrl-names = "default";
  pinctrl-0 = <&i2c2m1_xfer>;

  nxpnfc: nxpnfc@28 {
    status = "okay";
    compatible = "nxp,nxpnfc";
    reg = <0x28>;
    nxp,nxpnfc-irq = <&gpio3 RK_PB4 GPIO_ACTIVE_LOW>;
    nxp,nxpnfc-ven = <&gpio3 RK_PB3 GPIO_ACTIVE_LOW>;
    nxp,nxpnfc-fw-dwnld = <&gpio1 RK_PA0 GPIO_ACTIVE_LOW>;
  };
};

&i2c3 {
  status = "disabled";
};

&i2c4 {
  status = "disabled";
  clock-frequency = <100000>;

  gs_mxc6655xa: gs_mxc6655xa@15 {
    status = "disabled";
    compatible = "gs_mxc6655xa";
    pinctrl-names = "default";
    pinctrl-0 = <&mxc6655xa_irq_gpio>;
    reg = <0x15>;
    irq-gpio = <&gpio3 RK_PD7 IRQ_TYPE_LEVEL_LOW>;
    irq_enable = <0>;
    poll_delay_ms = <30>;
    type = <SENSOR_TYPE_ACCEL>;
    power-off-in-suspend = <1>;
    layout = <1>;
  };

  tc358743: tc358743@f {
    compatible = "toshiba,tc358743";
    status = "disabled";
    reg = <0x0f>;
    clocks = <&hdmi_osc>;
    clock-names = "refclk";
//    interrupt-parent = <&gpio0>;
//    interrupts = <29 IRQ_TYPE_LEVEL_HIGH>;
    reset-gpios = <&gpio0 RK_PD6 GPIO_ACTIVE_LOW>;
    pinctrl-names = "default";
    pinctrl-0 = <&tc358743_gpios>;
    rockchip,camera-module-index = <0>;
    rockchip,camera-module-facing = "back";
    rockchip,camera-module-name = "TC358743";
    rockchip,camera-module-lens-name = "NC";

    port {
      tc358743_out: endpoint {
        remote-endpoint = <&tc358743_in>;
        data-lanes = <1 2 3 4>;
//        clock-lanes = <0>;
        clock-noncontinuous;
        link-frequencies = /bits/ 64 <297000000>;
      };
    };
  };

  ov13850: ov13850@10 {
    compatible = "ovti,ov13850";
    status = "disabled";
    reg = <0x10>;
    power-domains = <&power RK3568_PD_VI>;
    clocks = <&cru CLK_CIF_OUT>, <&pmucru CLK_WIFI>;
    clock-names = "xvclk", "xvclk_2";
//    clocks = <&cru CLK_CIF_OUT>;
//    clock-names = "xvclk";
    /* avdd-supply = <>; */
    /* dvdd-supply = <>; */
    /* dovdd-supply = <>; */
    reset-gpios = <&gpio3 RK_PD4 GPIO_ACTIVE_HIGH>;
    pwdn-gpios = <&gpio0 RK_PD4 GPIO_ACTIVE_HIGH>;
    pinctrl-names = "rockchip,camera_default";
    pinctrl-0 = <&cif_clk>, <&refclk_pins>;
    rockchip,camera-module-index = <0>;
    rockchip,camera-module-facing = "back";
    rockchip,camera-module-name = "ZC-OV13850R2A-V1";
    rockchip,camera-module-lens-name = "Largan-50064B31";

    port {
      ov13850_out: endpoint {
        remote-endpoint = <&ov13850_in>;
        data-lanes = <1 2>;
      };
    };
  };

};

&i2c5 {
  status = "disabled";

  mxc6655xa: mxc6655xa@15 {
    status = "disabled";
    compatible = "gs_mxc6655xa";
    pinctrl-names = "default";
    pinctrl-0 = <&mxc6655xa_irq_gpio>;
    reg = <0x15>;
    irq-gpio = <&gpio3 RK_PC1 IRQ_TYPE_LEVEL_LOW>;
    irq_enable = <0>;
    poll_delay_ms = <30>;
    type = <SENSOR_TYPE_ACCEL>;
    power-off-in-suspend = <1>;
    layout = <1>;
  };
};

&i2s0_8ch {
  status = "okay";
};

&i2s1_8ch {
  status = "okay";
  rockchip,clk-trcm = <1>;
  pinctrl-names = "default";
  pinctrl-0 = <&i2s1m0_sclktx &i2s1m0_lrcktx &i2s1m0_sdi0 &i2s1m0_sdo0>;
};

&mdio0 {
  rgmii_phy0: phy@0 {
    compatible = "ethernet-phy-ieee802.3-c22";
    reg = <0x0>;
    clocks = <&cru CLK_MAC0_OUT>;
  };
};

&mdio1 {
  rgmii_phy1: phy@0 {
    compatible = "ethernet-phy-ieee802.3-c22";
    reg = <0x0>;
    clocks = <&cru CLK_MAC1_OUT>;
  };
};

&iep {
  status = "okay";
};

&iep_mmu {
  status = "okay";
};

&jpegd {
  status = "okay";
};

&jpegd_mmu {
  status = "okay";
};

&mpp_srv {
  status = "okay";
};

&nandc0 {
  #address-cells = <1>;
  #size-cells = <0>;
  status = "disabled";

  nand@0 {
    reg = <0>;
    nand-bus-width = <8>;
    nand-ecc-mode = "hw";
    nand-ecc-strength = <16>;
    nand-ecc-step-size = <1024>;
  };
};

 /*
  * There are 10 independent IO domains in RK3566/RK3568, including PMUIO[0:2] and VCCIO[1:7].
  * 1/ PMUIO0 and PMUIO1 are fixed-level power domains which cannot be configured;
  * 2/ PMUIO2 and VCCIO1,VCCIO[3:7] domains require that their hardware power supply voltages
  *    must be consistent with the software configuration correspondingly
  *  a/ When the hardware IO level is connected to 1.8V, the software voltage configuration
  *     should also be configured to 1.8V accordingly;
  *  b/ When the hardware IO level is connected to 3.3V, the software voltage configuration
  *     should also be configured to 3.3V accordingly;
  * 3/ VCCIO2 voltage control selection (0xFDC20140)
  *  BIT[0]: 0x0: from GPIO_0A7 (default)
  *  BIT[0]: 0x1: from GRF
  *    Default is determined by Pin FLASH_VOL_SEL/GPIO0_A7:
  *  L:VCCIO2 must supply 3.3V
  *  H:VCCIO2 must supply 1.8V
  */
&pmu_io_domains {
  status = "okay";
  pmuio2-supply = <&vcc3v3_pmu>;
  vccio1-supply = <&vccio_acodec>;
  vccio3-supply = <&vccio_sd>;
  vccio4-supply = <&vcc_1v8>;
  vccio5-supply = <&vcc_3v3>;
  vccio6-supply = <&vcc_1v8>;
  vccio7-supply = <&vcc_3v3>;
};

&pwm0 {
  status = "okay";
};

&pwm1 {
  status = "okay";
};

&pwm2 {
  status = "okay";
};

&pwm3 {
  status = "disabled";
};

&pwm4 {
  status = "okay";
};

&pwm5 {
  status = "okay";
};

&pwm6 {
  status = "okay";
};

&pwm7 {
  status = "okay";

  compatible = "rockchip,remotectl-pwm";
  remote_pwm_id = <7>;
  handle_cpu_id = <1>;
  remote_support_psci = <0>;
  pinctrl-names = "default";
  pinctrl-0 = <&pwm7_pins>;

  ir_key1 {
    rockchip,usercode = <0x4040>;
    rockchip,key_table =
      <0xf2  KEY_REPLY>,
      <0xba  KEY_BACK>,
      <0xf4  KEY_UP>,
      <0xf1  KEY_DOWN>,
      <0xef  KEY_LEFT>,
      <0xee  KEY_RIGHT>,
      <0xbd  KEY_HOME>,
      <0xea  KEY_VOLUMEUP>,
      <0xe3  KEY_VOLUMEDOWN>,
      <0xe2  KEY_SEARCH>,
      <0xb2  KEY_POWER>,
      <0xbc  KEY_MUTE>,
      <0xec  KEY_MENU>,
      <0xbf  0x190>,
      <0xe0  0x191>,
      <0xe1  0x192>,
      <0xe9  183>,
      <0xe6  248>,
      <0xe8  185>,
      <0xe7  186>,
      <0xf0  388>,
      <0xbe  0x175>;
  };

  ir_key2 {
    rockchip,usercode = <0xff00>;
    rockchip,key_table =
      <0xf9  KEY_HOME>,
      <0xbf  KEY_BACK>,
      <0xfb  KEY_MENU>,
      <0xaa  KEY_REPLY>,
      <0xb9  KEY_UP>,
      <0xe9  KEY_DOWN>,
      <0xb8  KEY_LEFT>,
      <0xea  KEY_RIGHT>,
      <0xeb  KEY_VOLUMEDOWN>,
      <0xef  KEY_VOLUMEUP>,
      <0xf7  KEY_MUTE>,
      <0xe7  KEY_POWER>,
      <0xfc  KEY_POWER>,
      <0xa9  KEY_VOLUMEDOWN>,
      <0xa8  KEY_VOLUMEDOWN>,
      <0xe0  KEY_VOLUMEDOWN>,
      <0xa5  KEY_VOLUMEDOWN>,
      <0xab  183>,
      <0xb7  388>,
      <0xe8  388>,
      <0xf8  184>,
      <0xaf  185>,
      <0xed  KEY_VOLUMEDOWN>,
      <0xee  186>,
      <0xb3  KEY_VOLUMEDOWN>,
      <0xf1  KEY_VOLUMEDOWN>,
      <0xf2  KEY_VOLUMEDOWN>,
      <0xf3  KEY_SEARCH>,
      <0xb4  KEY_VOLUMEDOWN>,
      <0xbe  KEY_SEARCH>;
  };

  ir_key3 {
    rockchip,usercode = <0x1dcc>;
    rockchip,key_table =
      <0xee  KEY_REPLY>,
      <0xf0  KEY_BACK>,
      <0xf8  KEY_UP>,
      <0xbb  KEY_DOWN>,
      <0xef  KEY_LEFT>,
      <0xed  KEY_RIGHT>,
      <0xfc  KEY_HOME>,
      <0xf1  KEY_VOLUMEUP>,
      <0xfd  KEY_VOLUMEDOWN>,
      <0xb7  KEY_SEARCH>,
      <0xff  KEY_POWER>,
      <0xf3  KEY_MUTE>,
      <0xbf  KEY_MENU>,
      <0xf9  0x191>,
      <0xf5  0x192>,
      <0xb3  388>,
      <0xbe  KEY_1>,
      <0xba  KEY_2>,
      <0xb2  KEY_3>,
      <0xbd  KEY_4>,
      <0xf9  KEY_5>,
      <0xb1  KEY_6>,
      <0xfc  KEY_7>,
      <0xf8  KEY_8>,
      <0xb0  KEY_9>,
      <0xb6  KEY_0>,
      <0xb5  KEY_BACKSPACE>;
  };
};

&rk_rga {
  status = "okay";
};

&rkvdec {
  status = "okay";
};

&rkvdec_mmu {
  status = "okay";
};

&rkvenc {
  venc-supply = <&vdd_logic>;
  status = "okay";
};

&rkvenc_mmu {
  status = "okay";
};

&rknpu {
  status = "disabled";
  rknpu-supply = <&vdd_npu>;
  memory-region = <&rknpu_reserved>;
};

&rknpu_mmu {
  status = "disabled";
};

&saradc {
  status = "okay";
  vref-supply = <&vcca_1v8>;
};

&sdhci {
  status = "okay";
  bus-width = <8>;
  supports-emmc;
  non-removable;
  max-frequency = <200000000>;
  no-sdio;
  no-sd;
  full-pwr-cycle-in-suspend;
//  cap-mmc-highspeed;
//  mmc-ddr-1_8v;
//  mmc-hs200-1_8v;
//  vmmc-supply = <&vcc_3v3>;
//  vqmmc-supply = <&vcc_1v8>;
};

&sdmmc0 {
  max-frequency = <150000000>;
  supports-sd;
  no-sdio;
  no-mmc;
  bus-width = <4>;
  cap-mmc-highspeed;
  cap-sd-highspeed;
  disable-wp;
  sd-uhs-sdr104;
  vmmc-supply = <&vcc3v3_sd>;
  vqmmc-supply = <&vccio_sd>;
  pinctrl-names = "default";
  pinctrl-0 = <&sdmmc0_bus4 &sdmmc0_clk &sdmmc0_cmd &sdmmc0_det>;
  status = "okay";
};

&sdmmc1 {
  status = "disabled";
};

&sdmmc2 {
  status = "okay";
  max-frequency = <150000000>;
  no-sd;
  no-mmc;
  supports-sdio;
  bus-width = <4>;
  disable-wp;
  cap-sd-highspeed;
  cap-sdio-irq;
  keep-power-in-suspend;
  mmc-pwrseq = <&sdio_pwrseq>;
  non-removable;
  pinctrl-names = "default";
  pinctrl-0 = <&sdmmc2m0_bus4 &sdmmc2m0_cmd &sdmmc2m0_clk>;
//  sd-uhs-sdr104;
};

&sfc {
  status = "okay";
};

&spdif_8ch {
  status = "disabled";
};

&tsadc {
  status = "okay";
};

&u2phy0_host {
  status = "okay";
};

&u2phy0_otg {
  status = "okay";
};

&u2phy1_host {
  status = "okay";
};

&u2phy1_otg {
  status = "okay";
};

&usb2phy0 {
  status = "okay";
};

&usb2phy1 {
  status = "okay";
};

&usb_host0_ehci {
  status = "okay";
};

&usb_host0_ohci {
  status = "okay";
};

&usb_host1_ehci {
  status = "okay";
};

&usb_host1_ohci {
  status = "okay";
};

&usbdrd_dwc3 {
  dr_mode = "otg";
  extcon = <&usb2phy0>;
  status = "okay";
};

&usbdrd30 {
  status = "okay";
};

&usbhost_dwc3 {
  status = "okay";
};

&usbhost30 {
  status = "okay";
};

&vad {
  rockchip,audio-src = <&i2s1_8ch>;
  rockchip,buffer-time-ms = <128>;
  rockchip,det-channel = <0>;
  rockchip,mode = <0>;
};

&vdpu {
  status = "okay";
};

&vdpu_mmu {
  status = "okay";
};

&vepu {
  status = "okay";
};

&vepu_mmu {
  status = "okay";
};

&vop {
  status = "okay";
  assigned-clocks = <&cru DCLK_VOP0>, <&cru DCLK_VOP1>;
  assigned-clock-parents = <&pmucru PLL_HPLL>, <&cru PLL_VPLL>;
  disable-win-move;
};

&vop_mmu {
  status = "okay";
};

&vp0 {
  cursor-win-id = <ROCKCHIP_VOP2_CLUSTER0>;
};

&vp1 {
  cursor-win-id = <ROCKCHIP_VOP2_CLUSTER1>;
};

&gmac0 {
  status = "okay";
  phy-mode = "rgmii";
//  clock_in_out = "input";
  clock_in_out = "output";

  snps,reset-gpio = <&gpio2 RK_PD3 GPIO_ACTIVE_LOW>;
  snps,reset-active-low;
  /* Reset time is 20ms, 100ms for rtl8211f */
  snps,reset-delays-us = <0 20000 100000>;

  assigned-clocks = <&cru SCLK_GMAC0_RX_TX>, <&cru SCLK_GMAC0>, <&cru CLK_MAC0_OUT>;
//  assigned-clock-parents = <&cru SCLK_GMAC0_RGMII_SPEED>, <&gmac0_clkin>;
  assigned-clock-parents = <&cru SCLK_GMAC0_RGMII_SPEED>, <&cru CLK_MAC0_2TOP>;
  assigned-clock-rates = <0>, <125000000>, <25000000>;

  pinctrl-names = "default";
  pinctrl-0 = <&gmac0_miim
         &gmac0_tx_bus2_level3
         &gmac0_rx_bus2
         &gmac0_rgmii_clk_level2
         &gmac0_rgmii_bus_level3
         &eth0_pins>;
//         &gmac0_clkinout

  tx_delay = <0x32>;
  rx_delay = <0x21>;
  max-speed = <1000>;

  phy-handle = <&rgmii_phy0>;
};

&gmac1 {
  status = "okay";
  phy-mode = "rgmii";
  clock_in_out = "output";

  snps,reset-gpio = <&gpio2 RK_PD1 GPIO_ACTIVE_LOW>;
  snps,reset-active-low;
  /* Reset time is 20ms, 100ms for rtl8211f */
  snps,reset-delays-us = <0 20000 100000>;

  assigned-clocks = <&cru SCLK_GMAC1_RX_TX>, <&cru SCLK_GMAC1>, <&cru CLK_MAC1_OUT>;
//  assigned-clock-parents = <&cru SCLK_GMAC1_RGMII_SPEED>, <&gmac1_clkin>;
  assigned-clock-parents = <&cru SCLK_GMAC1_RGMII_SPEED>, <&cru CLK_MAC1_2TOP>;
  assigned-clock-rates = <0>, <125000000>, <25000000>;

  pinctrl-names = "default";
  pinctrl-0 = <&gmac1m1_miim
    &gmac1m1_tx_bus2_level3
    &gmac1m1_rx_bus2
    &gmac1m1_rgmii_clk_level2
    &gmac1m1_rgmii_bus_level3
    &eth1m0_pins>;
//    &gmac1m1_clkinout

  tx_delay = <0x3d>;
  rx_delay = <0x1f>;
  max-speed = <1000>;

  phy-handle = <&rgmii_phy1>;
};

&pcie30phy {
  status = "okay";
};

&pcie3x2 {
  reset-gpios = <&gpio2 RK_PD6 GPIO_ACTIVE_HIGH>;
  vpcie3v3-supply = <&vcc3v3_pcie>;
  status = "okay";
};

&pcie2x1 {
  status = "disabled";
};

&combphy0_us {
  status = "okay";
};

&combphy1_usq {
  status = "okay";
};

&combphy2_psq {
  status = "okay";
};

&sata2 {
  status = "okay";
//  pinctrl-names = "default";
//  pinctrl-0 = <&sata2_pins>;
};

&uart3 {
  status = "okay";
};

&uart4 {
  status = "okay";
};

&uart7 {
  status = "disabled";
};

&uart8 {
  status = "okay";
  pinctrl-names = "default";
  pinctrl-0 = <&uart8m0_xfer>, <&uart8m0_ctsn>;
};

&uart9 {
  status = "disabled";
};

&rkisp {
  status = "okay";
};

&rkisp_mmu {
  status = "okay";
};

&csi2_dphy_hw {
  status = "okay";
};

&csi2_dphy1 {
  status = "disabled";
};

&csi2_dphy2 {
  status = "disabled";
};

&csi2_dphy0 {
  status = "okay";

  ports {
    #address-cells = <1>;
    #size-cells = <0>;
    port@0 {
      reg = <0>;
      #address-cells = <1>;
      #size-cells = <0>;

      tc358743_in: endpoint@0 {
        reg = <0>;
        remote-endpoint = <&tc358743_out>;
        data-lanes = <1 2 3 4>;
      };

      ov13850_in: endpoint@1 {
        reg = <1>;
        remote-endpoint = <&ov13850_out>;
        data-lanes = <1 2>;
      };

    };

    port@1 {
      reg = <1>;
      #address-cells = <1>;
      #size-cells = <0>;

      csi2_dphy0_out: endpoint@0 {
        reg = <0>;
        remote-endpoint = <&isp0_in_dphy0>;
//        remote-endpoint = <&mipi_csi2_input>;
//        data-lanes = <1 2 3 4>;
      };
    };
  };
};

&rkisp_vir0 {
  status = "okay";

  port {
    #address-cells = <1>;
    #size-cells = <0>;

    isp0_in_dphy0: endpoint@0 {
      reg = <0>;
      remote-endpoint = <&csi2_dphy0_out>;
//      remote-endpoint = <&mipi_lvds_sditf>;
    };

  };
};

&reserved_memory {
  cma {
    compatible = "shared-dma-pool";
    inactive;
    reusable;
    reg = <0x0 0x10000000 0x0 0x00800000>;
    linux,cma-default;
  };

  ramoops: ramoops@110000 {
    compatible = "ramoops";
    reg = <0x0 0x110000 0x0 0xf0000>;
    record-size = <0x20000>;
    console-size = <0x80000>;
    ftrace-size = <0x00000>;
    pmsg-size = <0x50000>;
  };

  rknpu_reserved: rknpu {
    compatible = "shared-dma-pool";
    inactive;
    reusable;
    size = <0x0 0x20000000>;
    alignment = <0x0 0x1000>;
  };
};

&rng {
  status = "okay";
};

&rockchip_suspend {
  status = "okay";
};

&xpcs {
  status = "okay";
};

&pinctrl {

  headphone {
    hp_det: hp-det {
      rockchip,pins = <1 RK_PB0 RK_FUNC_GPIO &pcfg_pull_up>;
    };
  };

  mxc6655xa {
    mxc6655xa_irq_gpio: mxc6655xa_irq_gpio {
      rockchip,pins = <3 RK_PD7 RK_FUNC_GPIO &pcfg_pull_none>;
    };
  };

  pmic {
    pmic_int: pmic_int {
      rockchip,pins =
        <0 RK_PA3 RK_FUNC_GPIO &pcfg_pull_up>;
    };
  };

  touch {
    touch_gpio: touch-gpio {
      rockchip,pins =
        <0 RK_PB5 RK_FUNC_GPIO &pcfg_pull_up>,
        <0 RK_PB6 RK_FUNC_GPIO &pcfg_pull_none>;
    };
  };

  sdio-pwrseq {
    wifi_enable_h: wifi-enable-h {
      rockchip,pins = <3 RK_PD5 RK_FUNC_GPIO &pcfg_pull_none>;
    };
  };

  wireless-wlan {
    wifi_host_wake_irq: wifi-host-wake-irq {
      rockchip,pins = <3 RK_PD4 RK_FUNC_GPIO &pcfg_pull_down>;
    };
  };

  wireless-bluetooth {
    uart8_gpios: uart8-gpios {
      rockchip,pins = <2 RK_PB1 RK_FUNC_GPIO &pcfg_pull_none>;
    };
  };

  hdmiin {
    tc358743_gpios: tc358743_gpios {
      rockchip,pins =
        <0 RK_PD6 RK_FUNC_GPIO &pcfg_pull_none>,
        <0 RK_PD5 RK_FUNC_GPIO &pcfg_pull_none>;
    };
  };

  bootinit {
    uboot_gpio: uboot-gpio {
      rockchip,pins =
        <0 RK_PC7 RK_FUNC_GPIO &pcfg_output_high>,
        <1 RK_PB2 RK_FUNC_GPIO &pcfg_output_low>,
        <1 RK_PB1 RK_FUNC_GPIO &pcfg_output_low>;
    };

    bootinit_gpio: bootinit-gpio {
      rockchip,pins =
        <0 RK_PC7 RK_FUNC_GPIO &pcfg_output_low>,
        <1 RK_PB2 RK_FUNC_GPIO &pcfg_output_high>,
        <1 RK_PB1 RK_FUNC_GPIO &pcfg_output_high>,
        <3 RK_PC1 RK_FUNC_GPIO &pcfg_pull_none>,
        <1 RK_PD2 RK_FUNC_GPIO &pcfg_pull_none>,
        <3 RK_PA1 RK_FUNC_GPIO &pcfg_pull_none>,
        <1 RK_PD3 RK_FUNC_GPIO &pcfg_pull_none>,
        <2 RK_PD0 RK_FUNC_GPIO &pcfg_pull_none>,
        <1 RK_PD4 RK_FUNC_GPIO &pcfg_pull_none>,
        <3 RK_PC3 RK_FUNC_GPIO &pcfg_pull_none>,
        <4 RK_PC4 RK_FUNC_GPIO &pcfg_pull_none>,
        <3 RK_PC2 RK_FUNC_GPIO &pcfg_pull_none>,
        <2 RK_PD7 RK_FUNC_GPIO &pcfg_pull_none>,
        <1 RK_PD1 RK_FUNC_GPIO &pcfg_pull_none>,
        <3 RK_PA7 RK_FUNC_GPIO &pcfg_pull_none>,
        <1 RK_PA1 RK_FUNC_GPIO &pcfg_pull_none>,
        <2 RK_PD2 RK_FUNC_GPIO &pcfg_output_high>;
    };
  };

};
