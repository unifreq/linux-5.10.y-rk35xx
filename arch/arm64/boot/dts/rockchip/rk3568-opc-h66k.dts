// SPDX-License-Identifier: (GPL-2.0+ OR MIT)
/*
 * Copyright (c) 2020 Rockchip Electronics Co., Ltd.
 *
 */

/dts-v1/;

#include "rk3568-hinlink.dtsi"

/ {
	model = "HINLINK OPC-H66K Board";
	compatible = "hinlink,h66k", "rockchip,rk3568";

	aliases {
		ethernet0 = &rtl8125_1;
		ethernet1 = &rtl8125_2;
	};
};
